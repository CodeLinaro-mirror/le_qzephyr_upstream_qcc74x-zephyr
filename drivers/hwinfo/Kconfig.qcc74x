## drivers/hwinfo/Kconfig.qcc74x
```kconfig
# Copyright (c) 2026 Qualcomm Technologies, Inc. and/or its subsidiaries
# SPDX-License-Identifier: BSD-3-Clause

config HWINFO_QCC74X
	bool "Qualcomm Opal hwinfo driver"
	default y
	help
	  Enables hwinfo driver for Opal MCUs.
```

## drivers/i2c/Kconfig.qcc74x
```kconfig
# Copyright (c) 2026 Qualcomm Technologies, Inc. and/or its subsidiaries
# SPDX-License-Identifier: BSD-3-Clause

config I2C_QCC74X
	bool "Qualcomm Opal I2C driver"
	default y
	depends on DT_HAS_QCOM_QCC74X_I2C_ENABLED
	select RING_BUFFER
	select PINCTRL
	help
	  Enable I2C driver for Opal MCUs.

if I2C_QCC74X

config I2C_QCC74X_DMA
	bool "Opal I2C DMA support"
	default n
	depends on DT_HAS_QCOM_QCC74X_DMA_ENABLED
	select DMA
	help
	  Select I2C DMA mode for I2C transfers.

endif # I2C_QCC74X
```

## drivers/i2s/Kconfig.qcc74x
```kconfig
# Copyright (c) 2026 Qualcomm Technologies, Inc. and/or its subsidiaries
# SPDX-License-Identifier: Apache-2.0

# Contains code under the following license:
#
# Not a contribution.
#
# Copyright (c) Zephyr Project members and individual contributors.
# SPDX-License-Identifier: Apache-2.0.

config I2S_QCC74X
	bool "Qualcomm Opal I2S driver"
	default y
	depends on DT_HAS_QCOM_QCC74X_I2S_ENABLED
	depends on DT_HAS_QCOM_QCC74X_DMA_ENABLED
	select PINCTRL
	select DMA
	help
	  Enables I2S driver for Opal MCUs.

if I2S_QCC74X

config I2S_QCC74X_RX_BLOCK_COUNT
	int "Opal I2S RX block count"
	default 8
	help
	  Max number of blocks waiting to be read from the I2S RX channel.

config I2S_QCC74X_TX_BLOCK_COUNT
	int "Opal I2S TX block count"
	default 8
	help
	  Max number of blocks waiting to be transmitted by the I2S TX channel.

endif
```

## drivers/ieee802154/Kconfig.qcc74x
```kconfig
# IEEE 802.15.4 QCC74x driver configuration
#
# Copyright (c) 2026 Qualcomm Technologies, Inc. and/or its subsidiaries
# SPDX-License-Identifier: BSD-3-Clause

config IEEE802154_QCC74X
	bool "QCC74x IEEE 802.15.4 radio driver"
	depends on IEEE802154
	help
	  Enable IEEE 802.15.4 support for QCC74x/QCC75x SoCs using
	  the lmac154 low-level MAC implementation.

if IEEE802154_QCC74X

config IEEE802154_QCC74X_CCA_MODE
	int "CCA mode (0=ED, 1=CS, 2=ED_AND_CS, 3=ED_OR_CS)"
	default 2
	range 0 3
	help
	  Clear Channel Assessment mode:
	  0 - Energy Detection only
	  1 - Carrier Sense only
	  2 - Energy Detection AND Carrier Sense
	  3 - Energy Detection OR Carrier Sense

config IEEE802154_QCC74X_CCA_THRESHOLD
	int "CCA ED threshold in dBm"
	default -71
	range -122 5
	help
	  Energy Detection threshold for CCA in dBm.

config IEEE802154_QCC74X_TX_POWER
	int "TX power in dBm"
	default 10
	range 0 14
	help
	  Transmit power in dBm (0 to 14).

config IEEE802154_QCC74X_DATA_RATE
	int "Data rate (0=250K, 1=500K, 2=1M, 3=2M)"
	default 0
	range 0 3
	help
	  IEEE 802.15.4 data rate:
	  0 - 250 kbps (standard, max 127 bytes)
	  1 - 500 kbps
	  2 - 1 Mbps
	  3 - 2 Mbps

config IEEE802154_QCC74X_MAX_RETRIES
	int "Maximum TX retries"
	default 3
	range 0 10
	help
	  Maximum number of TX retries when ACK is not received.

config IEEE802154_QCC74X_TX_TIMEOUT_MS
	int "TX completion timeout in milliseconds"
	default 200
	range 20 2000
	depends on IEEE802154_QCC74X
	help
	  Maximum time qcc74x_tx() waits for lmac154 to report completion via
	  the txParam.tx_done_cb callback. Covers CSMA-CA backoff plus ACK
	  timeout. On expiry the TX is aborted with -EIO so OpenThread retries,
	  preventing the radio work queue from blocking forever if the lmac154
	  TX FSM stalls and never fires its own timeout alarm.

config IEEE802154_QCC74X_MONITOR_INTERVAL_MS
	int "RF-FSM monitor interval in milliseconds"
	default 10
	range 10 1000
	depends on IEEE802154_QCC74X
	help
	  Interval at which the driver calls lmac154_monitor() to detect and
	  recover from a stuck radio FSM state (RX length == 255). Without
	  periodic monitoring, a stuck FSM causes every subsequent TX to time
	  out. Bouffalo calls this in its main loop; here it runs as a
	  delayed work item.

config IEEE802154_QCC74X_INIT_PRIORITY
	int "IEEE 802.15.4 QCC74x driver initialization priority"
	default 80
	depends on IEEE802154_QCC74X
	help
	  Initialization priority for the QCC74x IEEE 802.15.4 driver.
	  Higher priority means earlier initialization.

endif # IEEE802154_QCC74X
```

## drivers/ipm/Kconfig.qcc74x
```kconfig
# Copyright (c) 2026 Qualcomm Technologies, Inc. and/or its subsidiaries
# SPDX-License-Identifier: BSD-3-Clause

config IPM_QCC74X
	bool "Qualcomm Opal IPC IPM driver"
	default y
	depends on DT_HAS_QCOM_QCC74X_IPC_ENABLED
	help
	  Simple doorbell IPC for Opal MCUs.
```

## drivers/ir/Kconfig.qcc74x
```kconfig
# Copyright (c) 2026 Qualcomm Technologies, Inc. and/or its subsidiaries
# SPDX-License-Identifier: BSD-3-Clause

menuconfig IR
	bool "Qualcomm IR device driver"
	help
	  This option enables the IR custom driver class for Opal MCUs.

if IR

config IR_INIT_PRIORITY
	int "IR device drivers init priority"
	default KERNEL_INIT_PRIORITY_DEVICE
	help
	  IR device drivers init priority.

module = IR
module-str = ir
source "subsys/logging/Kconfig.template.log_config"

config IR_QCC74X
	bool "Qualcomm ir driver"
	default y
	select PINCTRL
	help
	  Enable Opal IR driver.

endif # IR
```

## drivers/mdio/Kconfig.qcc74x
```kconfig
# Copyright (c) 2026 Qualcomm Technologies, Inc. and/or its subsidiaries
# SPDX-License-Identifier: BSD-3-Clause

config MDIO_QCC74X
	bool "Qualcomm Opal MDIO driver"
	default y
	depends on DT_HAS_QCOM_QCC74X_MDIO_ENABLED
	select PINCTRL
	help
	  Enable MDIO driver for Opal MCUs.
```

## drivers/mipi_dbi/Kconfig.qcc74x
```kconfig
# Copyright (c) 2026 Qualcomm Technologies, Inc. and/or its subsidiaries
# SPDX-License-Identifier: BSD-3-Clause

config MIPI_DBI_QCC74X
	bool "Qualcomm Opal MIPI DBI driver"
	default y
	depends on DT_HAS_QCOM_QCC74X_MIPI_DBI_ENABLED
	select PINCTRL
	select GPIO
	help
	  Enable MIPI DBI driver for Opal MCUs.

if MIPI_DBI_QCC74X

config MIPI_DBI_QCC74X_USE_DMA
	bool "Use DMA for transfers with DBI driver"
	default n
	select DMA
	select EVENTS
	help
	  Use DMA for transfers when sending data with the DBI driver.
	  Commands will still be sent in polling mode.

endif # MIPI_DBI_QCC74X
```

## drivers/otp/Kconfig.qcc74x
```kconfig
# Copyright (c) Qualcomm Technologies, Inc. and/or its subsidiaries
# SPDX-License-Identifier: BSD-3-Clause

config OTP_QCC74X
	bool "Qualcomm QCC74x eFuse OTP driver"
	default y
	depends on OTP
	help
	  Exposes the QCC74x eFuse hardware through the Zephyr OTP API.
	  Enables otp_shell commands (CONFIG_OTP_SHELL) for reading and
	  optionally programming eFuse bytes on QCC74x platforms.

config OTP_QCC74X_SIZE
	int "eFuse size in bytes"
	default 512
	depends on OTP_QCC74X
	help
	  Total eFuse size in bytes. Must match the `size` property of the
	  efuse DTS node (default 512 bytes for QCC748).
```

## drivers/pinctrl/Kconfig.qc7xx
```kconfig
# Copyright (c) 2026 Qualcomm Technologies, Inc. and/or its subsidiaries
# SPDX-License-Identifier: Apache-2.0

config PINCTRL_QC7XX
	bool "QC7XX pin controller"
	default y
	depends on DT_HAS_QUALCOMM_QC7XX_PINCTRL_ENABLED
	help
	  Enables QC7XX pin controller
```

## drivers/pinctrl/Kconfig.qcc74x
```kconfig
# Copyright (c) 2026 Qualcomm Technologies, Inc. and/or its subsidiaries
# SPDX-License-Identifier: BSD-3-Clause

config PINCTRL_QCC74X
	bool "Qualcomm Opal pin control driver"
	default y
	depends on DT_HAS_QCOM_QCC74X_PINCTRL_ENABLED
	help
	  Enables pin control driver for Opal MCUs.
```

## drivers/psa/Kconfig.qcc74x
```kconfig
# Copyright (c) Qualcomm Technologies, Inc. and/or its subsidiaries.
# SPDX-License-Identifier: BSD-3-Clause
#
# QCC74x PSA Crypto Transparent Driver Kconfig options

menuconfig PSA_CRYPTO_DRIVER_QCC74X
	bool "QCC74X PSA Transparent Driver"
	default y
	depends on MBEDTLS_PSA_CRYPTO_C
	select PSA_CRYPTO_ACCELERATOR_DRIVER_PRESENT
	help
	  Enable PSA Crypto transparent acceleration using the QCC74X SEC
	  Engine hardware.

	  When enabled, PSA Crypto AES and SHA operations are offloaded to the
	  on-chip hardware engine.  The driver is registered in
	  psa_crypto_driver_wrappers.h via the PSA_CRYPTO_DRIVER_QCC74X
	  compile-time flag, which is generated automatically by CMake when
	  this option is set.

if PSA_CRYPTO_DRIVER_QCC74X

config PSA_CRYPTO_DRIVER_QCC74X_AES
	bool "QCC74X PSA AES acceleration"
	default y
	help
	  Enable AES hardware acceleration (ECB, CBC, CTR) via the QCC74X SEC
	  Engine.  Both one-shot (psa_cipher_encrypt) and streaming
	  (setup/set_iv/update/finish) paths are accelerated.

config PSA_CRYPTO_DRIVER_QCC74X_HASH
	bool "QCC74X PSA Hash acceleration"
	default y
	depends on CRYPTO
	depends on DT_HAS_QCOM_QCC74X_CRYPTO_ENABLED
	help
	  Enable QCC74X PSA transparent hash acceleration using direct LHAL
	  access. Supports SHA-1/224/256/384/512/512-224/512-256.

config QCC74X_AEAD_HW_ACCEL
	bool "QCC74X HW accelerated AEAD (AES-GCM)"
	depends on PSA_CRYPTO_DRIVER_QCC74X_AES
	help
	  Enable HW accelerated AES-GCM using HW AES-ECB for CTR keystream
	  and software GHASH (GF(2^128)) for authentication. The SEC Engine
	  does not support native GCM, so GHASH runs in software.

config QCC74X_AES_HWKEY
	bool "QCC74X AES OTP HW key for Secure Storage"
	depends on QCC74X_AEAD_HW_ACCEL
	help
	  Use OTP hardware key slot for AES operations instead of software key.
	  When enabled, the AEAD driver skips psa_import_key() and configures
	  the SEC Engine to use the OTP-fused hardware key directly.
	  Only affects the AEAD (AES-GCM) path for Secure Storage; does not
	  affect standalone AES cipher nor hash operations.

if QCC74X_AES_HWKEY

config QCC74X_AES_HWKEY_KEY_SEL0
	hex "HW key select bit 0"
	default 0x00
	help
	  First byte of the HW key selection (keysel0) passed to
	  qc7xx_aes_select_hwkey().  Consult the SEC Engine reference manual
	  for the efuse key table layout.

config QCC74X_AES_HWKEY_KEY_SEL1
	hex "HW key select bit 1"
	default 0x00
	help
	  Second byte of the HW key selection (keysel1) passed to
	  qc7xx_aes_select_hwkey().

config QCC74X_AES_HWKEY_KEY_SOURCE
	hex "HW key source"
	default 0x00
	help
	  Hardware key source selector passed to qc7xx_aes_set_hwkey_source().
	  0 = OTP efuse, 1 = secure key slot, etc.

endif # QCC74X_AES_HWKEY

endif # PSA_CRYPTO_DRIVER_QCC74X
```

## drivers/pwm/Kconfig.qcc74x
```kconfig
# Copyright (c) Qualcomm Technologies, Inc. and/or its subsidiaries
# SPDX-License-Identifier: BSD-3-Clause

config PWM_QCC74X
	bool "Qualcomm Opal PWM driver"
	default y
	depends on DT_HAS_QCOM_QCC74X_PWM_ENABLED
	depends on PWM
	select PINCTRL
	select PM_DEVICE if PM
	help
	  Enable PWM driver for Opal MCUs.
```

## drivers/reset/Kconfig.qcc74x
```kconfig
# Copyright (c) 2026 Qualcomm Technologies, Inc. and/or its subsidiaries
# SPDX-License-Identifier: BSD-3-Clause

config RESET_QCC74X
	bool "Qualcomm Opal RESET driver"
	default y
	depends on DT_HAS_QCOM_QCC74X_RESET_ENABLED
	depends on SOC_FAMILY_QCOM_QCC7XX
	help
	  Enable RESET driver for Opal MCUs.

config RESET_LOG_LEVEL
	int "Log level for reset controller drivers"
	default 2
	range 0 4
	help
	  Sets the log level for reset controller drivers.
	  0=Off, 1=Error, 2=Warning, 3=Info, 4=Debug
```

## drivers/rtc/Kconfig.qcc74x
```kconfig
# Copyright (c) 2026 Qualcomm Technologies, Inc. and/or its subsidiaries
# SPDX-License-Identifier: BSD-3-Clause

config RTC_QCC74X
	bool "Qualcomm Opal Real Time Clock driver"
	default y
	depends on DT_HAS_QCOM_QCC74X_RTC_ENABLED
	help
	  Enable Real Time Clock driver for Opal MCUs.
```

## drivers/sdhc/Kconfig.qcc74x
```kconfig
# Copyright (c) 2026 Qualcomm Technologies, Inc. and/or its subsidiaries
# SPDX-License-Identifier: BSD-3-Clause

config SDHC_QCC74X
	bool "Qualcomm Opal SDHC driver"
	default y
	depends on SDHC
	depends on DT_HAS_QCOM_QCC74X_SDHC_ENABLED
	select SDHC_SUPPORTS_NATIVE_MODE
	select PINCTRL
	help
	  Enables SD Host controller driver for Opal MCUs.

if SDHC_QCC74X

# cache line alignment
config SDHC_BUFFER_ALIGNMENT
	int "SDHC buffer alignment"
	default DCACHE_LINE_SIZE

endif
```

## drivers/sdio/Kconfig.qcc74x
```kconfig
# Copyright (c) 2026 Qualcomm Technologies, Inc. and/or its subsidiaries
# SPDX-License-Identifier: BSD-3-Clause

menuconfig SDIO
	bool "SDIO peripheral driver"
	help
	  This option enables the SDIO custom driver class for Opal MCUs.

if SDIO

config SDIO_INIT_PRIORITY
	int "SDIO peripheral drivers init priority"
	default KERNEL_INIT_PRIORITY_DEVICE
	help
	  SDIO peripheral drivers init priority.

module = SDIO
module-str = sdio
source "subsys/logging/Kconfig.template.log_config"

config SDIO_QCC74X
	bool "Qualcomm Opal SDIO driver"
	default y
	depends on DT_HAS_QCOM_QCC74X_SDIO_ENABLED
	select PINCTRL
	select GPIO
	help
	  Enables SDIO peripheral interface driver for Opal MCUs.

endif # SDIO
```

## drivers/serial/Kconfig.qcc74x
```kconfig
# Copyright (c) 2026 Qualcomm Technologies, Inc. and/or its subsidiaries
# SPDX-License-Identifier: Apache-2.0

# Contains code under the following license:
#
# Not a contribution.
#
# Copyright (c) Zephyr Project members and individual contributors.
# SPDX-License-Identifier: Apache-2.0.

config UART_QCC74X
	bool "Qualcomm Opal UART driver"
	default y
	depends on DT_HAS_QCOM_QCC74X_UART_ENABLED
	select SERIAL_HAS_DRIVER
	select SERIAL_SUPPORT_INTERRUPT
	select SERIAL_SUPPORT_ASYNC
	select PINCTRL
	help
		Enable UART driver for Opal MCUs.
		This driver supports polling, interrupt-driven, and asynchronous API.

if UART_QCC74X

config UART_QCC74X_ASYNC_TO_IRQ
	bool
	default y if UART_ASYNC_API
	select UART_INTERRUPT_DRIVEN
	help
	  Enforce interrupt-driven API when async is enabled.
	  The async implementation relies on RX timeout interrupts (RTO)
	  and DMA callbacks, so interrupt support is mandatory.

endif # UART_QCC74X
```
