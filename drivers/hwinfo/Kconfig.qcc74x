## drivers/spi/Kconfig.qcc74x
```kconfig
# Copyright (c) 2026 Qualcomm Technologies, Inc. and/or its subsidiaries
# SPDX-License-Identifier: BSD-3-Clause

config SPI_QCC74X
	bool "Qualcomm Opal SPI driver"
	default y
	depends on DT_HAS_QCOM_QCC74X_SPI_ENABLED
	depends on SPI
	select PINCTRL
	select GPIO
	help
	  Enable SPI driver for Opal MCUs.

if SPI_QCC74X

config SPI_QCC74X_DMA
	bool "Opal SPI DMA Support"
	select DMA
	help
	  Use the DMA for SPI transfer.

config SPI_QCC74X_DMA_FORCE_SINGLE_BLOCK_TEST
	bool "Force single-block DMA (test only)"
	default n
	depends on SPI_QCC74X_DMA
	help
	  Forces SPI DMA transfers to use bounce buffers so TX/RX are submitted
	  as a single DMA block when possible. Intended for debugging/testing.
	  For RX buffer sets with NULL gaps, the driver keeps the regular
	  multi-block path.

config SPI_QCC74X_DMA_SD_TX_CRC_DEBUG
	bool "Enable SD TX bounce CRC diagnostic (debug only)"
	default n
	depends on SPI_QCC74X_DMA
	help
	  Enables one-shot diagnostic logging for SD SPI write frames sent through
	  the TX bounce buffer. This is intended only for debug bring-up.

config SPI_QCC74X_INTERRUPT
	bool "Opal SPI interrupt-driven transfer support"
	depends on !SPI_QCC74X_DMA
	help
	  Enable interrupt-driven SPI transfers for the Opal SPI controller.
	  This allows non-blocking async transfers with completion callbacks.
	  Synchronous transfers can optionally use the interrupt path via
	  SPI_QCC74X_INTERRUPT_SYNC.
	  This option is mutually exclusive with SPI_QCC74X_DMA.

config SPI_QCC74X_INTERRUPT_SYNC
	bool "Use interrupt path for synchronous SPI transfers"
	default n
	depends on SPI_QCC74X_INTERRUPT
	help
	  When disabled, synchronous SPI transfers (spi_transceive/spi_write/spi_read)
	  use the polling path while asynchronous transfers can still use interrupts.
	  This is useful for peripherals with strict timing during command sequencing.

config SPI_QCC74X_INTERRUPT_THRESHOLD_TX
	int "TX FIFO interrupt threshold"
	default 16
	range 0 31
	depends on SPI_QCC74X_INTERRUPT
	help
	  TX FIFO threshold (tx_fifo_th) for interrupt generation.
	  Interrupt fires when tx_fifo_cnt > tx_fifo_th (available space exceeds threshold).
	  Lower values = interrupt fires sooner (less space needed), more interrupts.
	  Higher values = interrupt fires later, fewer interrupts but risk of underrun.
	  Default 16 means interrupt when >= 17 bytes free in 32-byte FIFO.

config SPI_QCC74X_INTERRUPT_THRESHOLD_RX
	int "RX FIFO interrupt threshold"
	default 0
	range 0 31
	depends on SPI_QCC74X_INTERRUPT
	help
	  RX FIFO threshold (rx_fifo_th) for interrupt generation.
	  Interrupt fires when rx_fifo_cnt > rx_fifo_th (available data exceeds threshold).
	  Lower values = interrupt fires sooner (less data needed), more responsive.
	  Higher values = interrupt fires later, fewer interrupts but risk of overrun.
	  Default 0 means interrupt when >= 1 byte available (most responsive).

endif # SPI_QCC74X
```

## drivers/syscon/Kconfig.qcc74x
```kconfig
# Copyright (c) 2026 Qualcomm Technologies, Inc. and/or its subsidiaries
# SPDX-License-Identifier: Apache-2.0

config SYSCON_QCC74X_EFUSE
	bool "Qualcomm Opal EFUSEs driver"
	default y
	depends on DT_HAS_QCOM_QCC74X_EFUSE_ENABLED
	help
	  E-Fuse access via SYSCON API for Opal platforms.
```

## drivers/usb/udc/Kconfig
```kconfig
# Copyright (c) 2026 Qualcomm Technologies, Inc. and/or its subsidiaries
# SPDX-License-Identifier: Apache-2.0

config UDC_QCC74X
	bool "Qualcomm Opal USB device controller driver"
	select UDC_DRIVER_HAS_HIGH_SPEED_SUPPORT
	imply UDC_WORKQUEUE
	default y
	depends on DT_HAS_QCOM_QCC74X_UDC_ENABLED
	help
	  Enable USB driver for Opal MCUs.

if UDC_QCC74X

config UDC_QCC74X_EVENT_COUNT
	int "Number or blocks in event slab"
	range 8 32
	default 16
	help
	  Number of blocks in slab for internal endpoint events.

endif # UDC_QCC74X
```

## drivers/video/Kconfig.qcc74x
```kconfig
# Copyright (c) 2026 Qualcomm Technologies, Inc. and/or its subsidiaries
# SPDX-License-Identifier: BSD-3-Clause

config VIDEO_QCC74X
	bool "Qualcomm Opal family Video driver"
	default y
	depends on DT_HAS_QCOM_QCC74X_CAM_ENABLED
	select PINCTRL
	select GPIO	
	help
	  Enable video driver for Opal MCUs.
```

## drivers/video/Kconfig.qcc74x_jpeg
```kconfig
# Copyright (c) 2026 Qualcomm Technologies, Inc. and/or its subsidiaries
# SPDX-License-Identifier: BSD-3-Clause

config VIDEO_QCC74X_JPEG
	bool "Opal JPEG HW encoder driver"
	default y
	depends on DT_HAS_QCOM_QCC74X_JPEG_ENABLED
	help
	  Enable driver for Opal JPEG HW Codec peripheral
```

## drivers/watchdog/Kconfig.qcc74x
```kconfig
# Copyright (c) 2026 Qualcomm Technologies, Inc. and/or its subsidiaries
# SPDX-License-Identifier: BSD-3-Clause

config WDT_QCC74X
	bool "Qualcomm Opal Watchdog (WDT) Driver"
	default y
	depends on DT_HAS_QCOM_QCC74X_WATCHDOG_ENABLED
	depends on WATCHDOG
	select HAS_WDT_DISABLE_AT_BOOT
	help
	  Enable WDT driver for Opal MCUs.
```

## drivers/wifi/qc7xx/Kconfig.qc7xx
```kconfig
# Copyright (c) 2026 Qualcomm Technologies, Inc. and/or its subsidiaries
# SPDX-License-Identifier: BSD-3-Clause


menuconfig WIFI_QCC74X
	bool "SOC WiFi support"
	default n
	select NET_L2_WIFI_MGMT
	select WIFI_USE_NATIVE_NETWORKING
	help
	  Enable SOC WiFi support. Only supported in single
	  core mode because the network stack is not aware of SMP
	  stuff.
menuconfig WIFI_QCC75X
	bool "SOC WiFi support"
	default n
	select NET_L2_WIFI_MGMT
	select WIFI_USE_NATIVE_NETWORKING
	help
	  Enable SOC WiFi support. Only supported in single
	  core mode because the network stack is not aware of SMP
	  stuff.

if WIFI_QCC74X || WIFI_QCC75X

config SOC_WIFI_MBEDTLS_CRYPTO
	bool "Use MbedTLS crypto APIs"
	default n
	select MBEDTLS_ECP_C
	select MBEDTLS_ECDH_C
	select MBEDTLS_ECDSA_C
	select MBEDTLS_PKCS5_C
	select MBEDTLS_PK_WRITE_C
	select MBEDTLS_CIPHER_MODE_CTR_ENABLED
	select MBEDTLS_CMAC
	select MBEDTLS_ENTROPY_C
	help
	  Select this option to use MbedTLS crypto APIs which utilize hardware acceleration.

config SOC_WIFI_DEBUG_PRINT
	bool "Print debug messages from WPA Supplicant"
	default n
	help
	  Select this option to print logging information from WPA supplicant,
	  this includes handshake information and key hex dumps depending
	  on the project logging level.

	  Enabling this could increase the build size ~60kb
	  depending on the project logging level.

config QC7XX_WIFI_STA_AUTO_DHCPV4
	bool "Automatically starts DHCP4 negotiation"
	depends on NET_DHCPV4
	depends on NET_IPV4
	help
	  WiFi driver will automatically initiate DHCPV4 negotiation when connected.

config QC7XX_WIFI_AP_STA_MODE
	bool "Activates the Station/AP co-existence mode."
	depends on WIFI_NM
	select NET_DHCPV4_SERVER if NET_IPV4 && NET_UDP
	help
	  The Station/AP coexistence mode allows the SOC to operate as both a station and
	  an access point simultaneously. This mode is not enabled by default.

if QC7XX_WIFI_AP_STA_MODE

config QC7XX_WIFI_SOFTAP_IP_ADDRESS
	string "QCC7xx SoftAP IPv4 address"
	default "192.168.4.1"

config QC7XX_WIFI_SOFTAP_IP_MASK
	string "QCC7xx SoftAP IPv4 netmask"
	default "255.255.255.0"

config QC7XX_WIFI_SOFTAP_IP_BASE
	string "QCC7xx SoftAP DHCPv4 base address"
	default "192.168.4.2"

endif # QC7XX_WIFI_AP_STA_MODE

config CSIDMA_CLI
	bool "QCC74x CSI DMA capture and shell commands"
	depends on WIFI_QCC74X
	depends on SHELL
	default n
	help
	  Enable QCC74x Wi-Fi CSI DMA capture and shell commands.

menuconfig QCC74X_WIFI_ANTENNA_DIVERSITY
	bool "QCC74x Wi-Fi antenna diversity"
	depends on WIFI_QCC74X
	select GPIO
	default n
	help
	  Enable board-controlled Wi-Fi antenna diversity using an RF-switch GPIO.

if QCC74X_WIFI_ANTENNA_DIVERSITY

config QCC74X_WIFI_ANTENNA_DIVERSITY_STATIC
	bool "Static scan-based antenna selection"
	default n
	help
	  Requires BL Wi-Fi archives that export the static scan command handlers.
	  The v2.1.12 QCC743 archives do not provide them, so keep this disabled
	  unless matching archives are installed.

config QCC74X_WIFI_ANTENNA_DIVERSITY_DYNAMIC
	bool "Dynamic RSSI-based antenna selection"
	default n

config QCC74X_WIFI_ANTENNA_DIVERSITY_SHELL
	bool "Antenna diversity shell commands"
	depends on SHELL
	default y

endif # QCC74X_WIFI_ANTENNA_DIVERSITY

config QCC74X_WIFI_PS_SUPPORT
	bool
	depends on WIFI_QCC74X
	depends on SOC_SERIES_QCC74X
	help
	  Internal switch for building the QCC74X vendor Wi-Fi stack with its
	  power-save backend. PDS15 low power and Wi-Fi/BLE coexistence both
	  use this backend, but they remain separate user-visible features.

config QCC74X_WIFI_LOW_POWER
	bool "Enable QCC74X Wi-Fi low-power support"
	depends on WIFI_QCC74X
	depends on SOC_SERIES_QCC74X
	select QCC74X_WIFI_PS_SUPPORT
	help
	  Build the QCC74X Wi-Fi stack with the vendor power-save path used
	  by PDS15 validation.

config QCC74X_WIFI_COEX
	bool "Enable QCC74X Wi-Fi/BLE coexistence support"
	depends on WIFI_QCC74X
	depends on SOC_SERIES_QCC74X
	select QCC74X_WIFI_PS_SUPPORT
	help
	  Build the QCC74X Wi-Fi/BLE coexistence runtime. This enables the
	  vendor Wi-Fi power-save backend and exposes sample validation APIs,
	  but does not enable coexistence automatically at boot.

config QCC74X_WIFI_COEX_STATS
	bool "Enable QCC74X Wi-Fi/BLE coexistence timeslice statistics"
	depends on QCC74X_WIFI_COEX
	default n
	help
	  Build optional coex timeslice statistics for validation. This is off
	  by default to keep the production Wi-Fi path small.

config SOC_WIFI_STA_RECONNECT
	bool "WiFi connection retry"
	help
	  Enable automatic Wi-Fi reconnection after an unexpected disconnect.

	  While a connection or reconnection is in progress, a new Wi-Fi connect
	  request is rejected with -EALREADY. Wait for the current connection
	  attempt to complete before submitting another request.

config QC7XX_SOCKET_OFFLOAD
	bool "QC7xx Socket Offload Support"
	depends on NET_SOCKETS_OFFLOAD && WIFI_QCC75X
	default y
	# select NET_SOCKETS_OFFLOAD_DISPATCHER  # Commented out to allow manual control
	select OPENAMP
	select RPMSG_SERVICE
	help
	  Enable socket offload support for QC7xx AP core.
	  Sockets created on AP core will be offloaded to NP core via RPMsg RPC.
	  This allows applications to use standard POSIX socket APIs while
	  the actual socket operations are performed on the NP core.

config QC7XX_SOCKET_OFFLOAD_PRIORITY
	int "QC7xx Socket Offload Priority"
	depends on QC7XX_SOCKET_OFFLOAD
	default 40
	help
	  Processing priority for QC7xx offloaded sockets. Lower values have
	  higher priority. This should be set lower than native socket priority
	  to prefer offloaded sockets when available.

config QC7XX_SOCKET_OFFLOAD_MAX_SOCKETS
	int "Maximum number of offloaded sockets"
	depends on QC7XX_SOCKET_OFFLOAD
	default 64
	range 8 256
	help
	  Maximum number of sockets that can be offloaded from AP core to NP core.
	  Each socket consumes memory on both AP and NP cores.

config QC7XX_IPC_SOCKET_TIMEOUT_MS
	int "IPC socket operation timeout (ms)"
	depends on QC7XX_SOCKET_OFFLOAD
	default 5000
	range 1000 30000
	help
	  Timeout for IPC socket operations between AP and NP core in milliseconds.
	  If an operation takes longer than this timeout, it will fail with ETIMEDOUT.

config QC7XX_SOCKET_OFFLOAD_DEBUG
	bool "Debug logging for QC7xx socket offload"
	depends on QC7XX_SOCKET_OFFLOAD
	help
	  Enable detailed debug logging for socket offload operations.
	  This includes socket creation, IPC communications, and error conditions.

endif
```
