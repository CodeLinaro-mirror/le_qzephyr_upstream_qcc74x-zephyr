## boards/qcom/qcc75xm_evk/board.yml
```yaml
# Copyright (c) 2026 Qualcomm Technologies, Inc. and/or its subsidiaries
# SPDX-License-Identifier: Apache-2.0

# Contains code under the following license:
#
# Not a contribution.
#
# Copyright (c) Zephyr Project members and individual contributors.
# SPDX-License-Identifier: Apache-2.0

board:
  name: qcc75xm_evk
  full_name: QCC75xM Evaluation Kit
  vendor: qcom
  socs:
    - name: qcc75x
      variants:
        - name: cpu0
        - name: cpu1
```

## boards/qcom/qcr373_evk/Kconfig
```kconfig
# Copyright (c) Qualcomm Technologies, Inc. and/or its subsidiaries
# SPDX-License-Identifier: BSD-3-Clause

menu "QCC75x EVK options"

config QCR373_OCRAM_SIZE_AP
	hex "OCRAM used by AP"
	default 0x50000

config QCR373_WRAM_SIZE_AP
	hex "WRAM used by AP"
	default 0x50000

config QCR373_CODE_SIZE_AP
	hex "Code size used by AP"
	default 0x300000

config QCR373_PSRAM_DATA_SIZE_AP
	hex "PSRAM data size used by AP"
	default 0x200000

config QCR373_CODE_SIZE_NP
	hex "Code size used by NP"
	default 0x200000

endmenu
```

## boards/qcom/qcr373_evk/Kconfig.qcr373_evk
```kconfig
# Copyright (c) Qualcomm Technologies, Inc. and/or its subsidiaries
# SPDX-License-Identifier: BSD-3-Clause

config BOARD_QCR373_EVK
	select SOC_QCR373
	select SOC_QCR373_AP if !BOARD_QCR373_EVK_QCR373_NP
	select SOC_QCR373_NP if BOARD_QCR373_EVK_QCR373_NP
```

## boards/qcom/qcr373_evk/board.yml
```yaml
# Copyright (c) Qualcomm Technologies, Inc. and/or its subsidiaries
# SPDX-License-Identifier: BSD-3-Clause

board:
  name: qcr373_evk
  full_name: QCC75xM Evaluation Kit
  vendor: qcom
  socs:
    - name: qcr373
      variants:
        - name: ap
        - name: np
```

## boards/qcom/qcr373_evk/qcr373_evk_defconfig
```kconfig
# Copyright (c) Qualcomm Technologies, Inc. and/or its subsidiaries.
# All rights reserved.
# Confidential and Proprietary - Qualcomm Technologies, Inc.
#
# Contains code under the following license:
#
# Not a contribution.
#
# Copyright (c) Zephyr Project members and individual contributors.
# SPDX-License-Identifier: Apache-2.0

CONFIG_MAIN_STACK_SIZE=4096
CONFIG_CONSOLE=y
CONFIG_SERIAL=y
CONFIG_UART_CONSOLE=y
CONFIG_GPIO=y

CONFIG_FLASH_SIZE=8

# Start bluetooth config
CONFIG_BT_LL_SW_SPLIT=n
CONFIG_BT_HCI_ACL_FLOW_CONTROL=n
# bluetooth debug log enable
#CONFIG_BT_HCI_DRIVER_LOG_LEVEL_DBG=y
# End bluetooth config

# Enable soc late initialization hook
CONFIG_SOC_LATE_INIT_HOOK=y
CONFIG_LOG_MODE_IMMEDIATE=y
CONFIG_LOG=y
```

## boards/qcom/qcr373_evk/qcr373_evk_qcr373_ap_defconfig
```kconfig
# Copyright (c) Qualcomm Technologies, Inc. and/or its subsidiaries
# SPDX-License-Identifier: BSD-3-Clause

CONFIG_MAIN_STACK_SIZE=4096
CONFIG_CONSOLE=y
CONFIG_SERIAL=y
CONFIG_UART_CONSOLE=y
CONFIG_GPIO=y

CONFIG_FLASH_SIZE=8

CONFIG_RESET=y

CONFIG_BOARD_FLASH_INIT_SKIP=y

CONFIG_SOC_LATE_INIT_HOOK=y
CONFIG_LOG_MODE_IMMEDIATE=y
CONFIG_LOG=y
```

## boards/qcom/qcr373_evk/qcr373_evk_qcr373_np_defconfig
```kconfig
# Copyright (c) Qualcomm Technologies, Inc. and/or its subsidiaries
# SPDX-License-Identifier: BSD-3-Clause

CONFIG_MAIN_STACK_SIZE=4096
CONFIG_CONSOLE=y
CONFIG_SERIAL=y
CONFIG_UART_CONSOLE=y
CONFIG_GPIO=y

CONFIG_FLASH_SIZE=8

CONFIG_BT_LL_SW_SPLIT=n
CONFIG_BT_BUF_ACL_RX_SIZE=251
CONFIG_BT_HCI_ACL_FLOW_CONTROL=n

CONFIG_SOC_LATE_INIT_HOOK=y
CONFIG_LOG_MODE_IMMEDIATE=y
CONFIG_LOG=y
```

## boards/qcom/qcr373m3_evb/Kconfig.qcr373m3_evb
```kconfig
# Copyright (c) Qualcomm Technologies, Inc. and/or its subsidiaries
# SPDX-License-Identifier: BSD-3-Clause

config BOARD_QCR373M3_EVB
	select SOC_QCR3733
	select SOC_QCR3XX_AP if !BOARD_QCR373M3_EVB_QCR3XX_NP
	select SOC_QCR3XX_NP if BOARD_QCR373M3_EVB_QCR3XX_NP
```

## boards/qcom/qcr373m3_evb/board.yml
```yaml
# Copyright (c) Qualcomm Technologies, Inc. and/or its subsidiaries
# SPDX-License-Identifier: BSD-3-Clause

board:
  name: qcr373m3_evb
  full_name: QCR373M Evaluation Kit
  vendor: qcom
  socs:
    - name: qcr3733
      variants:
        - name: ap
        - name: np
```

## drivers/Kconfig
```kconfig
# Copyright (c) 2026 Qualcomm Technologies, Inc. and/or its subsidiaries
# SPDX-License-Identifier: BSD-3-Clause

menu "Device Drivers"

# zephyr-keep-sorted-start
rsource "adc/Kconfig.qcc74x"
rsource "audio/Kconfig.qcc74x"
rsource "bluetooth/hci/Kconfig.qcc74x"
rsource "cache/Kconfig.qcc74x"
rsource "can/Kconfig.qcc74x"
rsource "clock_control/Kconfig.qcc74x"
rsource "comparator/Kconfig.qcc74x"
rsource "counter/Kconfig.qcc74x"
rsource "crypto/Kconfig.qcc74x"
rsource "dac/Kconfig.qcc74x"
rsource "dma/Kconfig.qcc74x"
rsource "entropy/Kconfig.qcc74x"
rsource "ethernet/Kconfig.qcc74x"
rsource "flash/Kconfig.qcc74x"
rsource "gpio/Kconfig.qcc74x"
rsource "hwinfo/Kconfig.qcc74x"
rsource "i2c/Kconfig.qcc74x"
rsource "i2s/Kconfig.qcc74x"
rsource "ieee802154/Kconfig.qcc74x"
rsource "ir/Kconfig.qcc74x"
rsource "ipm/Kconfig.qcc74x"
rsource "mdio/Kconfig.qcc74x"
rsource "mipi_dbi/Kconfig.qcc74x"
rsource "pinctrl/Kconfig.qcc74x"
rsource "pinctrl/Kconfig.qc7xx"
rsource "pwm/Kconfig.qcc74x"
rsource "reset/Kconfig.qcc74x"
rsource "rtc/Kconfig.qcc74x"
rsource "sdhc/Kconfig.qcc74x"
rsource "sdio/Kconfig.qcc74x"
rsource "serial/Kconfig.qcc74x"
rsource "spi/Kconfig.qcc74x"
rsource "syscon/Kconfig.qcc74x"
rsource "usb/Kconfig.qcc74x"
rsource "video/Kconfig.qcc74x"
rsource "video/Kconfig.qcc74x_jpeg"
rsource "watchdog/Kconfig.qcc74x"
rsource "wifi/qc7xx/Kconfig.qc7xx"
# zephyr-keep-sorted-stop

endmenu
```

## drivers/adc/Kconfig.qcc74x
```kconfig
# Copyright (c) 2026 Qualcomm Technologies, Inc. and/or its subsidiaries
# SPDX-License-Identifier: Apache-2.0

# Contains code under the following license:
#
# Not a contribution.
#
# Copyright (c) Zephyr Project members and individual contributors.
# SPDX-License-Identifier: Apache-2.0

config ADC_QCC74X
	bool "Qualcomm Opal ADC driver"
	default y
	depends on ADC
	depends on DT_HAS_QCOM_QCC74X_ADC_ENABLED
	select ADC_CONFIGURABLE_INPUTS
	help
	  Enables ADC driver for Opal MCUs.

if ADC_QCC74X

config ADC_QCC74X_CHANNEL_COUNT_SETUP
	int "Number of ADC channels supported by the driver"
	range 1 32
	default 12
	help
	  Number of ADC channels that can be setup. The number should be >=
	  ADC_QCC74X_CHANNEL_COUNT. It is possible to setup
	  ADC_QCC74X_CHANNEL_COUNT_SETUP channels, but read only
	  ADC_QCC74X_CHANNEL_COUNT channels in one sequence.

config ADC_QCC74X_CHANNEL_COUNT
	int "Number of ADC channels supported by the driver"
	range 1 12
	default 12
	help
	  Number of ADC channels supported by the driver in scanning conversion
	  mode. This is the maximum number of channels that can be read in
	  one sequence.

config ADC_QCC74X_DMA
	bool "OAPL ADC DMA Support"
	default n
	depends on DT_HAS_QCOM_QCC74X_DMA_ENABLED
	select DMA
	help
	  Enable ADC DMA mode for ADC instances that enable DMA channels in
	  their device tree nodes.

endif # ADC_QCC74X
```

## drivers/audio/Kconfig.qcc74x
```kconfig
# Copyright (c) 2026 Qualcomm Technologies, Inc. and/or its subsidiaries
# SPDX-License-Identifier: BSD-3-Clause

#
# Audio ADC options
#
menuconfig AUDIO_ADC
	bool "Audio Analog-to-Digital Converter (ADC) drivers"
	help
	  Enable audio ADC (Audio Analog to Digital Converter) driver configuration.

if AUDIO_ADC

config AUDIO_ADC_INIT_PRIORITY
	int "Audio ADC init priority"
	default KERNEL_INIT_PRIORITY_DEVICE
	help
	  Audio ADC driver device initialization priority.

module = AUDIO_ADC
module-str = audio ADC
source "subsys/logging/Kconfig.template.log_config"

config AUDIO_ADC_QCC74X
	bool "Opal audio ADC driver"
	default y
	depends on AUDIO
	depends on AUDIO_ADC
	depends on DT_HAS_QCOM_QCC74X_AUDIO_ADC_ENABLED
	depends on DT_HAS_QCOM_QCC74X_DMA_ENABLED
	select DMA
	help
	  Enables Opal audio ADC driver.

endif # AUDIO_ADC

#
# Audio DAC options
#
menuconfig AUDIO_DAC
	bool "Audio Digital-to-Analog Converter (DAC) drivers"
	help
	  Enable audio DAC (Audio Digital to Analog Converter) driver configuration.

if AUDIO_DAC

config AUDIO_DAC_INIT_PRIORITY
	int "Audio DAC init priority"
	default KERNEL_INIT_PRIORITY_DEVICE
	help
	  Audio DAC driver device initialization priority.

module = AUDIO_DAC
module-str = audio DAC
source "subsys/logging/Kconfig.template.log_config"

config AUDIO_DAC_QCC74X
	bool "Opal audio DAC driver"
	default y
	depends on AUDIO
	depends on AUDIO_DAC
	depends on DT_HAS_QCOM_QCC74X_AUDIO_DAC_ENABLED
	depends on DT_HAS_QCOM_QCC74X_DMA_ENABLED
	select DMA
	help
	  Enables Opal audio DAC driver.

endif # AUDIO_DAC
```

## drivers/bluetooth/hci/Kconfig.qcc74x
```kconfig
# Copyright (c) 2026 Qualcomm Technologies, Inc. and/or its subsidiaries
# SPDX-License-Identifier: BSD-3-Clause

config BT_QCC74X
	bool "Qualcomm Opal BT_HCI driver"
	default y
	depends on BT
	depends on DT_HAS_QCOM_QCC74X_BT_HCI_ENABLED
	help
	  Enables BT_HCI bluetooth driver for Opal MCUs.

if BT_QCC74X

config BT_BUF_ACL_RX_SIZE
		int
		default 251

config HEAP_MEM_POOL_SIZE
	int "Heap Memory Pool Size"
	default 8192
	help
	  Specifies the size of the heap memory pool in bytes.

endif
```

## drivers/cache/Kconfig.qcc74x
```kconfig
# Copyright (c) 2026 Qualcomm Technologies, Inc. and/or its subsidiaries
# SPDX-License-Identifier: BSD-3-Clause

config CACHE_QCC74X
	bool "Qualcomm Opal L1 Cache Driver"
	default y
	depends on CACHE_MANAGEMENT
	select CACHE_HAS_DRIVER
	help
	  This option enables the CACHE driver for Opal MCUs.
```

## drivers/can/Kconfig.qcc74x
```kconfig
# Copyright (c) 2026 Qualcomm Technologies, Inc. and/or its subsidiaries
# SPDX-License-Identifier: Apache-2.0

config CAN_QCC74X
	bool "Qualcomm Opal CAN Driver"
	default y
	depends on DT_HAS_QCOM_QCC74X_CAN_ENABLED
	select PINCTRL
	help
	  This option enables the CAN driver for Opal MCUs.

if CAN_QCC74X

config CAN_MAX_FILTER
	int "Maximum number of concurrent active filters"
	default 4
	range 1 32
	help
	  Maximum number of filters supported by the can_add_rx_callback() API call.

endif # CAN_QCC74X
```

## drivers/clock_control/Kconfig.qcc74x
```kconfig
# Copyright (c) 2026 Qualcomm Technologies, Inc. and/or its subsidiaries
# SPDX-License-Identifier: BSD-3-Clause

config CLOCK_CONTROL_QCC74X
	bool "Qualcomm Opal Clock Control Driver"
	default y
	depends on DT_HAS_QCOM_QCC74X_CLOCK_CONTROLLER_ENABLED
	help
	  This option enables the CLOCK CONTROL driver for Opal MCUs.
```

## drivers/comparator/Kconfig.qcc74x
```kconfig
# Copyright (c) 2026 Qualcomm Technologies, Inc. and/or its subsidiaries
# SPDX-License-Identifier: BSD-3-Clause

config COMPARATOR_QCC74X
	bool "Qualcomm Opal Analog Comparator Driver"
	default y
	depends on COMPARATOR
	select PINCTRL
	select GPIO
	help
	  Enable Analog Comparator driver for Opal MCUs.
```

## drivers/counter/Kconfig.qcc74x
```kconfig
# Copyright (c) 2026 Qualcomm Technologies, Inc. and/or its subsidiaries
# SPDX-License-Identifier: BSD-3-Clause

config COUNTER_TMR_QCC74X
	bool "Qualcomm Opal Counter Driver based on GP-Timers"
	default y
	depends on DT_HAS_QCOM_QCC74X_TIMER_ENABLED
	depends on COUNTER
	help
	  Enables the Counter driver API based on General
	  Purpose Timers for Opal MCUs.
```

## drivers/crypto/Kconfig.qcc74x
```kconfig
# Copyright (c) 2026 Qualcomm Technologies, Inc. and/or its subsidiaries
# SPDX-License-Identifier: BSD-3-Clause

config CRYPTO_QCC74X
	bool "Qualcomm Opal cipher and hash driver"
	default y
	depends on DT_HAS_QCOM_QCC74X_CRYPTO_ENABLED
	help
	  Enable Crypto Driver for Opal MCUs.

config CRYPTO_QCC74X_SHA_MAX_SESSION
	int "Maximum of sessions crypto driver can handle"
	default 10
	depends on CRYPTO_QCC74X
	help
	  This can be used to tweak the amount of sessions the driver
	  can handle in parallel.

config CRYPTO_QCC74X_CIPHER_MAX_SESSION
	int "Maximum of sessions cipher driver can handle"
	default 10
	depends on CRYPTO_QCC74X
	help
	  This can be used to tweak the amount of sessions the driver
	  can handle in parallel.
```

## drivers/dac/Kconfig.qcc74x
```kconfig
# Copyright (c) 2026 Qualcomm Technologies, Inc. and/or its subsidiaries
# SPDX-License-Identifier: BSD-3-Clause

config DAC_QCC74X
	bool "Qualcomm Opal DAC driver"
	default y
	depends on DAC
	depends on DT_HAS_QCOM_QCC74X_DAC_ENABLED
	select PINCTRL
	help
	  Enable DAC driver for Opal MCUs.

if DAC_QCC74X

config DAC_QCC74X_DMA
	bool "Opal DAC DMA support"
	default y
	depends on DT_HAS_QCOM_QCC74X_DMA_ENABLED
	select DMA
	help
	  Select DAC DMA mode for DAC data source.

endif # DAC_QCC74X
```

## drivers/dma/Kconfig.qcc74x
```kconfig
# Copyright (c) 2026 Qualcomm Technologies, Inc. and/or its subsidiaries
# SPDX-License-Identifier: BSD-3-Clause

config DMA_QCC74X
	bool "Qualcomm Opal DMA driver"
	depends on DT_HAS_QCOM_QCC74X_DMA_ENABLED
	default y
	help
	  Enables DMA driver for Opal MCUs.

if DMA_QCC74X

config DMA_CH_TRANSFER_BLOCK_MAX
	int "QC7XX Block Transfer Maximum Count"
	default 10

config DMA_CH_TRANSFER_LLI_MAX
	int "QC7XX LLI Transfer Maximum Count"
	default 20

endif # DMA_QCC74X
```

## drivers/entropy/Kconfig.qcc74x
```kconfig
# Copyright (c) 2026 Qualcomm Technologies, Inc. and/or its subsidiaries
# SPDX-License-Identifier: Apache-2.0

# Contains code under the following license:
#
# Not a contribution.
#
# Copyright (c) Zephyr Project members and individual contributors.
# SPDX-License-Identifier: Apache-2.0

config ENTROPY_RNG_QCC74X
	bool "Qualcomm Opal entropy number generator driver"
	default y
	depends on ENTROPY_GENERATOR
	depends on DT_HAS_QCOM_QCC74X_TRNG_ENABLED
	select ENTROPY_HAS_DRIVER
	help
	  This option enables the entropy number generator for Opal MCUs.
```

## drivers/ethernet/Kconfig.qcc74x
```kconfig
# Copyright (c) 2026 Qualcomm Technologies, Inc. and/or its subsidiaries
# SPDX-License-Identifier: BSD-3-Clause

menuconfig ETH_QCC74X_EMAC
	bool "Qualcomm Opal Ethernet driver for emac"
	default y
	depends on DT_HAS_QCOM_QCC74X_EMAC_ENABLED
	select MDIO
	select PINCTRL
	select GPIO
	help
	  Enable Ethernet driver for Opal MCUs.

if ETH_QCC74X_EMAC

config ETH_QCC74X_EMAC_RX_THREAD_STACK_SIZE
	int "Opal Ethernet receive thread stack size"
	default 768

config ETH_QCC74X_EMAC_RX_THREAD_PRIORITY
	int "Opal Ethernet receive thread priority"
	default 2

config ETH_QCC74X_EMAC_TX_BUFF_CNT
	int "Opal Ethernet TX Buffer Count"
	default 6

config ETH_QCC74X_EMAC_RX_BUFF_CNT
	int "Opal Ethernet RX Buffer Count"
	default 10

endif # ETH_QCC74X_EMAC
```

## drivers/flash/Kconfig.qcc74x
```kconfig
# Copyright (c) 2026 Qualcomm Technologies, Inc. and/or its subsidiaries
# SPDX-License-Identifier: BSD-3-Clause

config SOC_FLASH_QCC74X
	bool "Qualcomm Opal flash driver"
	default y
	depends on DT_HAS_QCOM_QCC74X_FLASH_CONTROLLER_ENABLED
	select FLASH_HAS_DRIVER_ENABLED
	select FLASH_HAS_PAGE_LAYOUT
	select FLASH_HAS_EXPLICIT_ERASE
	help
	  Enable flash driver for Opal MCUs.
```

## drivers/gpio/Kconfig.qcc74x
```kconfig
# Copyright (c) 2026 Qualcomm Technologies, Inc. and/or its subsidiaries
# SPDX-License-Identifier: BSD-3-Clause

config GPIO_QCC74X
	bool "Qualcomm Opal GPIO driver"
	default y
	depends on DT_HAS_QCOM_QCC74X_GPIO_ENABLED
	depends on GPIO
	help
	  Enable GPIO driver for Opal MCUs.
```
