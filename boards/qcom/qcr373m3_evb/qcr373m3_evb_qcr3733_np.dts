/*
 * Copyright (c) Qualcomm Technologies, Inc. and/or its subsidiaries
 * SPDX-License-Identifier: BSD-3-Clause
 */

#include "qcr373m3_evb.dts"

/ {
	chosen {
		zephyr,console = &uart1;
		zephyr,shell-uart = &uart1;
	};
};

&uart0 {
	status = "disabled";
};

&uart1 {
	status = "okay";
};
