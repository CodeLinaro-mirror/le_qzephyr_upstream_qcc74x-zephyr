## Kconfig
```kconfig
# Copyright (c) 2026 Qualcomm Technologies, Inc. and/or its subsidiaries
# SPDX-License-Identifier: Apache-2.0

# Contains code under the following license:
#
# Not a contribution.
#
# Copyright (c) Zephyr Project members and individual contributors.
# SPDX-License-Identifier: Apache-2.0.

rsource "drivers/Kconfig"
```

## boards/qcom/qcc743m1r_evk/Kconfig
```kconfig
# Copyright (c) 2026 Qualcomm Technologies, Inc. and/or its subsidiaries
# SPDX-License-Identifier: BSD-3-Clause

config HEAP_MEM_POOL_ADD_SIZE_BOARD
	int
	default 4096
```

## boards/qcom/qcc743m1r_evk/Kconfig.qcc743m1r_evk
```kconfig
# Copyright (c) 2026 Qualcomm Technologies, Inc. and/or its subsidiaries
# SPDX-License-Identifier: BSD-3-Clause

config BOARD_QCC743M1R_EVK
	select SOC_QCC7431
```

## boards/qcom/qcc743m1r_evk/board.yml
```yaml
# Copyright (c) 2026 Qualcomm Technologies, Inc. and/or its subsidiaries
# SPDX-License-Identifier: BSD-3-Clause

board:
  name: qcc743m1r_evk
  full_name: QCC743M-1 Evaluation Kit
  vendor: qcom
  socs:
    - name: qcc7431
```

## boards/qcom/qcc743m_evk/Kconfig.qcc743m_evk
```kconfig
# Copyright (c) 2026 Qualcomm Technologies, Inc. and/or its subsidiaries
# SPDX-License-Identifier: BSD-3-Clause

config BOARD_QCC743M_EVK
	select SOC_QCC743
```

## boards/qcom/qcc743m_evk/Kconfig.sysbuild
```kconfig
# Copyright (c) 2026 Qualcomm Technologies, Inc. and/or its subsidiaries
# SPDX-License-Identifier: Apache-2.0

# Contains code under the following license:
#
# Not a contribution.
#
# Copyright (c) Zephyr Project members and individual contributors.
# SPDX-License-Identifier: Apache-2.0.

choice BOOTLOADER
	default BOOTLOADER_MCUBOOT
endchoice

choice BOOT_SIGNATURE_TYPE
	default BOOT_SIGNATURE_TYPE_NONE
endchoice
```

## boards/qcom/qcc743m_evk/board.yml
```yaml
# Copyright (c) 2026 Qualcomm Technologies, Inc. and/or its subsidiaries
# SPDX-License-Identifier: BSD-3-Clause

board:
  name: qcc743m_evk
  full_name: QCC743M Evaluation Kit
  vendor: qcom
  socs:
    - name: qcc743
```

## boards/qcom/qcc744m2_evk/Kconfig.qcc744m2_evk
```kconfig
# Copyright (c) 2026 Qualcomm Technologies, Inc. and/or its subsidiaries
# SPDX-License-Identifier: BSD-3-Clause

config BOARD_QCC744M2_EVK
	select SOC_QCC744
```

## boards/qcom/qcc744m2_evk/board.yml
```yaml
# Copyright (c) 2026 Qualcomm Technologies, Inc. and/or its subsidiaries
# SPDX-License-Identifier: BSD-3-Clause

board:
  name: qcc744m2_evk
  full_name: QCC744M Evaluation Kit
  vendor: qcom
  socs:
  - name: qcc744
```

## boards/qcom/qcc744m2r_evk/board.yml
```yaml
# Copyright (c) 2026 Qualcomm Technologies, Inc. and/or its subsidiaries
# SPDX-License-Identifier: BSD-3-Clause

board:
  name: qcc744m2r_evk
  full_name: QCC744M-2 Evaluation Kit
  vendor: qcom
  socs:
  - name: qcc7442
```

## boards/qcom/qcc744m2r_evk/qcc744m2r_evk_defconfig
```kconfig
# Copyright (c) Qualcomm Technologies, Inc. and/or its subsidiaries
# SPDX-License-Identifier: BSD-3-Clause

CONFIG_CONSOLE=y
CONFIG_SERIAL=y
CONFIG_UART_CONSOLE=y

CONFIG_RESET=y
```

## boards/qcom/qcc744m_evk/Kconfig
```kconfig
# Copyright (c) 2026 Qualcomm Technologies, Inc. and/or its subsidiaries
# SPDX-License-Identifier: Apache-2.0

# Contains code under the following license:
#
# Not a contribution.
#
# Copyright (c) Zephyr Project members and individual contributors.
# SPDX-License-Identifier: Apache-2.0.

config HEAP_MEM_POOL_ADD_SIZE_BOARD
	int
	default 4096
```

## boards/qcom/qcc744m_evk/board.yml
```yaml
# Copyright (c) 2026 Qualcomm Technologies, Inc. and/or its subsidiaries
# SPDX-License-Identifier: Apache-2.0

# Contains code under the following license:
#
# Not a contribution.
#
# Copyright (c) Zephyr Project members and individual contributors.
# SPDX-License-Identifier: Apache-2.0.

board:
  name: qcc744m_evk
  full_name: QCC744M Evaluation Kit
  vendor: qcom
  socs:
  - name: qcc744
```

## boards/qcom/qcc748m3_evk/board.yml
```yaml
# Copyright (c) Qualcomm Technologies, Inc. and/or its subsidiaries
# SPDX-License-Identifier: BSD-3-Clause

board:
  name: qcc748m3_evk
  full_name: QCC748M-3 Evaluation Kit
  vendor: qcom
  socs:
  - name: qcc7483
```

## boards/qcom/qcc748m_evk/Kconfig
```kconfig
# Copyright (c) 2026 Qualcomm Technologies, Inc. and/or its subsidiaries
# SPDX-License-Identifier: Apache-2.0

config HEAP_MEM_POOL_ADD_SIZE_BOARD
	int
	default 4096

config BOARD_PARTITION_CFG_FILE
	string "Partition configuration file"
	default "partition_cfg_flash_8M_psram_4M.toml" if PSRAM
	default "partition_cfg_4M.toml"
	help
	  Partition table file name relative to the board directory,
	  or an application-provided path.
	  Use partition_cfg_flash_8M_psram_4M.toml for 8M Flash + 4M PSRAM
	  execution mode (FW.len=0xA8000000, boot2 copies FW to PSRAM).
	  Use the qcom-748m-evk-flash-8M-psram-8M snippet for 8M PSRAM boards.

config PSRAM_LENGTH
	hex "PSRAM total size in bytes"
	depends on PSRAM
	default 0x400000
	help
	  Total PSRAM size in bytes (4 MB = 0x400000, 8 MB = 0x800000).
	  Must match the physical PSRAM on the board and the partition table.
	  Override via the qcom-748m-evk-flash-8M-psram-8M snippet for 8M boards.

config PSRAM_REGION_FLASH_SHADOW_SIZE
	hex "PSRAM flash shadow region size"
	default 0x200000
	help
	  Size of the PSRAM region used for shadowing code and data from
	  external flash into PSRAM. This option must be consistent with the
	  linker script memory layout.
```

## boards/qcom/qcc748m_evk/Kconfig.qcc748m_evk
```kconfig
# Copyright (c) 2026 Qualcomm Technologies, Inc. and/or its subsidiaries
# SPDX-License-Identifier: BSD-3-Clause

config BOARD_QCC748M_EVK
	select SOC_QCC748
```

## boards/qcom/qcc748m_evk/Kconfig.sysbuild
```kconfig
# Copyright (c) 2026 Qualcomm Technologies, Inc. and/or its subsidiaries
# SPDX-License-Identifier: BSD-3-Clause

choice BOOTLOADER
	default BOOTLOADER_MCUBOOT
endchoice

choice BOOT_SIGNATURE_TYPE
	default BOOT_SIGNATURE_TYPE_NONE
endchoice
```

## boards/qcom/qcc748m_evk/board.yml
```yaml
# Copyright (c) Qualcomm Technologies, Inc. and/or its subsidiaries
# SPDX-License-Identifier: BSD-3-Clause

board:
  name: qcc748m_evk
  full_name: QCC748M Evaluation Kit
  vendor: qcom
  revision:
    format: major.minor.patch
    default: "3.1.0"
    revisions:
      - name: "2.1.0"
      - name: "3.1.0"
  socs:
  - name: qcc748
```

## boards/qcom/qcc748m_evk/qcc748m_evk_defconfig
```kconfig
# Copyright (c) 2026 Qualcomm Technologies, Inc. and/or its subsidiaries
# SPDX-License-Identifier: Apache-2.0

CONFIG_CONSOLE=y
CONFIG_SERIAL=y
CONFIG_UART_CONSOLE=y

CONFIG_RESET=y
```

## boards/qcom/qcc751m2_evk/Kconfig.qcc751m2_evk
```kconfig
# Copyright (c) 2026 Qualcomm Technologies, Inc. and/or its subsidiaries
# SPDX-License-Identifier: BSD-3-Clause

config BOARD_QCC751M2_EVK
	select SOC_QCC7512
```

## boards/qcom/qcc751m2_evk/board.yml
```yaml
# Copyright (c) 2026 Qualcomm Technologies, Inc. and/or its subsidiaries
# SPDX-License-Identifier: BSD-3-Clause

board:
  name: qcc751m2_evk
  full_name: QCC751M-2 Evaluation Kit
  vendor: qcom
  socs:
    - name: qcc7512
      variants:
        - name: cpu0
        - name: cpu1
```

## boards/qcom/qcc75xm_evk/Kconfig
```kconfig
# Copyright (c) 2026 Qualcomm Technologies, Inc. and/or its subsidiaries
# SPDX-License-Identifier: BSD-3-Clause

menu "QCC75x EVK options"

config QCC75X_OCRAM_SIZE_CPU0
	hex "OCRAM used by CPU0"
	default 0x50000

config QCC75X_WRAM_SIZE_CPU0
	hex "WRAM used by CPU0"
	default 0x50000

config QCC75X_CODE_SIZE_CPU0
	hex "Code size used by CPU0"
	default 0x300000

config QCC75X_PSRAM_DATA_SIZE_CPU0
	hex "PSRAM data size used by CPU0"
	default 0x200000

config QCC75X_OCRAM_SIZE_CPU1
	hex "OCRAM used by CPU1"
	default 0x00000000

config QCC75X_WRAM_SIZE_CPU1
	hex "WRAM used by CPU1"
	default 0x00000

config QCC75X_L2RAM_SIZE_CPU1
	hex "L2RAM used by CPU1"
	default 0x28000

config QCC75X_CODE_SIZE_CPU1
	hex "Code size used by CPU1"
	default 0x200000

config QCC75X_PSRAM_DATA_SIZE_CPU1
	hex "PSRAM data size used by CPU1"
	default 0x100000

config HEAP_MEM_POOL_ADD_SIZE_BOARD
	int
	default 4096

endmenu
```

## boards/qcom/qcc75xm_evk/Kconfig.qcc75xm_evk
```kconfig
# Copyright (c) 2026 Qualcomm Technologies, Inc. and/or its subsidiaries
# SPDX-License-Identifier: Apache-2.0

# Contains code under the following license:
#
# Not a contribution.
#
# Copyright (c) Zephyr Project members and individual contributors.
# SPDX-License-Identifier: Apache-2.0

config BOARD_QCC75XM_EVK
	select SOC_QCC75X
```
