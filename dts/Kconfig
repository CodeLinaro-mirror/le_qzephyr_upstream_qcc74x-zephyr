## dts/Kconfig
```kconfig
# Copyright (c) 2026 Qualcomm Technologies, Inc. and/or its subsidiaries
# SPDX-License-Identifier: BSD-3-Clause

menu "Devicetree Info"

osource "$(KCONFIG_BINARY_DIR)/Kconfig.dts"

endmenu
```

## dts/bindings/adc/qcom,qcc74x-adc.yaml
```yaml
# Copyright (c) 2026 Qualcomm Technologies, Inc. and/or its subsidiaries
# SPDX-License-Identifier: BSD-3-Clause

description: Qualcomm Opal family ADC controller

compatible: "qcom,qcc74x-adc"

include: [adc-controller.yaml, pinctrl-device.yaml]

properties:
  clk_div:
    type: int
    required: true
    description: ADC clock division ratio.
      Possible values are 4, 8, 12, 16, 20, 24, 32.

  vref-select:
    type: int
    default: 0
    enum: [0, 1]
    description: |
      Internal reference voltage selection.
        0 - 3.2 V (default)
        1 - 2.0 V

  "#io-channel-cells":
    const: 1

io-channel-cells:
  - input
```

## dts/bindings/adc/qualcomm,qc7xx-adc.yaml
```yaml
# Copyright (c) 2022 Wolter HV <wolterhv@gmx.de>
#
# SPDX-License-Identifier: Apache-2.0

description: |
  Qualcomm QC7XX ADC

compatible: "qualcomm,qc7xx-adc"

include: [adc-controller.yaml, pinctrl-device.yaml]

properties:

  clk_div:
    type: int
    required: true
    description: ADC clock division ratio.
      Possible values are 4,8,12,16,20,24,32.

  "#io-channel-cells":
    const: 1

io-channel-cells:
  - input
```

## dts/bindings/audio/qcom,qcc74x-audio-adc.yaml
```yaml
# Copyright (c) 2025 Qualcomm Technologies, Inc. and/or its subsidiaries
# SPDX-License-Identifier: Apache-2.0

description: Qualcomm Opal family audio ADC

compatible: "qcom,qcc74x-audio-adc"

include: [base.yaml, pinctrl-device.yaml]

properties:
  clk_div:
    type: int
    required: true
    description: Audio ADC clock division ratio.
      Should be less or equal 0x3F (63 dec).
```

## dts/bindings/audio/qcom,qcc74x-audio-dac.yaml
```yaml
# Copyright (c) 2026 Qualcomm Technologies, Inc. and/or its subsidiaries
# SPDX-License-Identifier: BSD-3-Clause

description: Qualcomm Opal family audio DAC

compatible: "qcom,qcc74x-audio-dac"

include: [base.yaml, pinctrl-device.yaml]

properties:
  clk_div:
    type: int
    required: true
    description: Audio DAC clock division ratio.
      Should be less or equal 0xFF (255 dec).
```

## dts/bindings/bluetooth/qcom,qcc74x-bt-hci.yaml
```yaml
# Copyright (c) 2026 Qualcomm Technologies, Inc. and/or its subsidiaries
# SPDX-License-Identifier: BSD-3-Clause

description: Qualcomm Opal family Bluetooth HCI controller

compatible: "qcom,qcc74x-bt-hci"

include: [bt-hci.yaml, reset-device.yaml]

properties:
  bt-hci-name:
    default: "BT qcc74x"
  bt-hci-bus:
    default: "virtual"
  resets:
    required: true
```

## dts/bindings/bluetooth/qualcomm,qc7xx-bt-hci.yaml
```yaml
# Copyright (c) 2026 Qualcomm Technologies, Inc. and/or its subsidiaries
# SPDX-License-Identifier: BSD-3-Clause

description: Bluetooth HCI for qualcomm

compatible: "qualcomm,qc7xx-bt-hci"

include: bt-hci.yaml

properties:
  bt-hci-name:
    default: "BT qc7xx"
  bt-hci-bus:
    default: "virtual"
```

## dts/bindings/can/qcom,qcc74x-can.yaml
```yaml
# Copyright (c) 2026 Qualcomm Technologies, Inc. and/or its subsidiaries
# SPDX-License-Identifier: BSD-3-Clause

description: Qualcomm Opal family CAN controller

compatible: "qcom,qcc74x-can"

include: [can-controller.yaml, pinctrl-device.yaml, reset-device.yaml]

properties:
  reg:
    required: true

  clocks:
    required: true

  pinctrl-0:
    required: true

  pinctrl-names:
    required: true
```

## dts/bindings/clock/qcom,qcc74x-clock-controller.yaml
```yaml
# Copyright (c) 2026 Qualcomm Technologies, Inc. and/or its subsidiaries
# SPDX-License-Identifier: Apache-2.0

# Contains code under the following license:
#
# Not a contribution.
#
# Copyright (c) Zephyr Project members and individual contributors.
# SPDX-License-Identifier: Apache-2.0.

description: Qualcomm Opal family Clock Controller

compatible: "qcom,qcc74x-clock-controller"

include: [clock-controller.yaml, base.yaml, pinctrl-device.yaml]

properties:
  "#clock-cells":
    const: 2

  wifi-pll-type:
    type: int
    default: 0
    enum:
      - 0
      - 1
    description: Wifi PLL option.
                 One of the following
                 QC7XX_WIFI_PLL_960M (0)
                 QC7XX_WIFI_PLL_OFF  (1)

  audio-pll-type:
    type: int
    enum:
      - 0
      - 1
      - 2
      - 3
      - 4
      - 5
      - 6
    description: Audio PLL option.
                 One of the following
                 QC7XX_AUDIO_PLL_491P52M (0)
                 QC7XX_AUDIO_PLL_451P58M (1)
                 QC7XX_AUDIO_PLL_400M    (2)
                 QC7XX_AUDIO_PLL_384M    (3)
                 QC7XX_AUDIO_PLL_245P76M (4)
                 QC7XX_AUDIO_PLL_240M    (5)
                 QC7XX_AUDIO_PLL_OFF     (6)

  xtal-type:
    type: int
    default: 4
    enum:
      - 0
      - 1
      - 2
      - 3
      - 4
      - 5
      - 6
      - 7
    description: XTAL type. One of the following
                 QC7XX_XTAL_NONE (0)
                 QC7XX_XTAL_24M  (1)
                 QC7XX_XTAL_32M  (2)
                 QC7XX_XTAL_38P4M(3)
                 QC7XX_XTAL_40M  (4)
                 QC7XX_XTAL_26M  (5)
                 QC7XX_XTAL_RC32M(6)
                 QC7XX_XTAL_MAX  (7)

  f32k-clk-src:
    default: 0
    type: int
    description: Clock source selection for 32kHz clock.
      Possible values are following
      - QC7XX_HBN_32K_RC   (0)
      - QC7XX_HBN_32K_XTAL (1)
      - QC7XX_HBN_32K_DIG  (3)

  dig-clk-src:
    type: int
    default: 255
    description: Clock source selection for DIG clock.
      Possible values are following
      - QC7XX_DIG_CLK_WIFIPLL_32M (0)
      - QC7XX_DIG_CLK_XCLK        (1)
      - QC7XX_DIG_CLK_AUPLL       (2)

  clk-in-freq:
    type: int
    required: false
    default: 0
    description: Frequency of external clock signal provided to
                 clock input pin (in Hertz).

clock-cells:
  - id
  - source
```

## dts/bindings/clock/qualcomm,qc7xx-cctl.yaml
```yaml
# SPDX-License-Identifier: Apache-2.0

description: |
  Qualcomm Reset and Clock Unit (RCU) if a multi-function peripheral in
  charge of reset control (RCTL) and clock control (CCTL) for all SoC
  peripherals. This binding represents the clock controller (CCTL).

  To specify the clocks in a peripheral, the standard clocks property needs
  to be used.

  Predefined RCU clock cells are available in
  include/zephyr/dts-bindings/clock/bl{xxx}-clocks.h header files, where {xxx}
  corresponds to the SoC series, e.g. f4xx.

compatible: "qualcomm,qc7xx-cctl"

include: [clock-controller.yaml, base.yaml]

properties:
  "#clock-cells":
    const: 1

clock-cells:
  - id
```

## dts/bindings/comparator/qcom,qcc74x-acomp.yaml
```yaml
# Copyright (c) 2026 Qualcomm Technologies, Inc. and/or its subsidiaries
# SPDX-License-Identifier: Apache-2.0

# Contains code under the following license:
#
# Not a contribution.
#
# Copyright (c) Zephyr Project members and individual contributors.
# SPDX-License-Identifier: Apache-2.0.

description: Qualcomm Opal family Analog Comparator

compatible: "qcom,qcc74x-acomp"

include: base.yaml

properties:
  interrupts:
    required: true

  reg:
    required: true

  acomp_id:
    type: int

  mux_enable:
    type: boolean

  pos_chan_sel:
    type: string
    enum:
      - AON_ACOMP_CHAN_ADC0
      - AON_ACOMP_CHAN_ADC1
      - AON_ACOMP_CHAN_ADC2
      - AON_ACOMP_CHAN_ADC3
      - AON_ACOMP_CHAN_ADC4
      - AON_ACOMP_CHAN_ADC5
      - AON_ACOMP_CHAN_ADC6
      - AON_ACOMP_CHAN_ADC7
      - AON_ACOMP_CHAN_DACA
      - AON_ACOMP_CHAN_DACB
      - AON_ACOMP_CHAN_VREF_1P25V
      - AON_ACOMP_CHAN_VIO_X_SCALING_FACTOR_1
      - AON_ACOMP_CHAN_VIO_X_SCALING_FACTOR_2
      - AON_ACOMP_CHAN_VIO_X_SCALING_FACTOR_3
      - AON_ACOMP_CHAN_VIO_X_SCALING_FACTOR_4
      - AON_ACOMP_CHAN_VSS
    description: Positive channel select

  neg_chan_sel:
    type: string
    enum:
      - AON_ACOMP_CHAN_ADC0
      - AON_ACOMP_CHAN_ADC1
      - AON_ACOMP_CHAN_ADC2
      - AON_ACOMP_CHAN_ADC3
      - AON_ACOMP_CHAN_ADC4
      - AON_ACOMP_CHAN_ADC5
      - AON_ACOMP_CHAN_ADC6
      - AON_ACOMP_CHAN_ADC7
      - AON_ACOMP_CHAN_DACA
      - AON_ACOMP_CHAN_DACB
      - AON_ACOMP_CHAN_VREF_1P25V
      - AON_ACOMP_CHAN_VIO_X_SCALING_FACTOR_1
      - AON_ACOMP_CHAN_VIO_X_SCALING_FACTOR_2
      - AON_ACOMP_CHAN_VIO_X_SCALING_FACTOR_3
      - AON_ACOMP_CHAN_VIO_X_SCALING_FACTOR_4
      - AON_ACOMP_CHAN_VSS
    description: Negative channel select

  vio_sel:
    type: int
    description: VIO voltage select, (vioSel/66)*avdd33

  scaling_factor:
    type: string
    enum:
      - AON_ACOMP_SCALING_FACTOR_0P25
      - AON_ACOMP_SCALING_FACTOR_0P5
      - AON_ACOMP_SCALING_FACTOR_0P75
      - AON_ACOMP_SCALING_FACTOR_1
    description: Scaling factor level select

  bias_prog:
    type: string
    enum:
      - AON_ACOMP_BIAS_POWER_MODE1
      - AON_ACOMP_BIAS_POWER_MODE2
      - AON_ACOMP_BIAS_POWER_MODE3
      - AON_ACOMP_BIAS_POWER_NONE
    description: Bias current control, modes 1,2,3 refer to slow, medium and fast repsonse.

  hysteresis_pos_volt:
    type: string
    enum:
      - AON_ACOMP_HYSTERESIS_VOLT_NONE
      - AON_ACOMP_HYSTERESIS_VOLT_10MV
      - AON_ACOMP_HYSTERESIS_VOLT_20MV
      - AON_ACOMP_HYSTERESIS_VOLT_30MV
      - AON_ACOMP_HYSTERESIS_VOLT_40MV
      - AON_ACOMP_HYSTERESIS_VOLT_50MV
      - AON_ACOMP_HYSTERESIS_VOLT_60MV
      - AON_ACOMP_HYSTERESIS_VOLT_70MV
    description: hysteresis voltage for positive

  hysteresis_neg_volt:
    type: string
    enum:
      - AON_ACOMP_HYSTERESIS_VOLT_NONE
      - AON_ACOMP_HYSTERESIS_VOLT_10MV
      - AON_ACOMP_HYSTERESIS_VOLT_20MV
      - AON_ACOMP_HYSTERESIS_VOLT_30MV
      - AON_ACOMP_HYSTERESIS_VOLT_40MV
      - AON_ACOMP_HYSTERESIS_VOLT_50MV
      - AON_ACOMP_HYSTERESIS_VOLT_60MV
      - AON_ACOMP_HYSTERESIS_VOLT_70MV
    description: hysteresis voltage for negative
```

## dts/bindings/counter/qcom,qcc74x-timer.yaml
```yaml
# Copyright (c) 2026 Qualcomm Technologies, Inc. and/or its subsidiaries
# SPDX-License-Identifier: BSD-3-Clause

description: Qualcomm Opal family timer controller

compatible: "qcom,qcc74x-timer"

include: [reset-device.yaml, base.yaml]

properties:
  reg:
    required: true

  channels:
    type: int
    required: true
    description: Number of timer channels.

  clock-gate:
    type: int
    required: false
    description: Shared peripheral clock gate for the TIMER hardware block.

  clocks:
    required: true

  clock-div:
    type: int
    default: 0
    description: Timer prescaler.

  resets:
    required: true

  counter-mode:
    type: int
    default: 0
    description: Timer counter mode definition.

  preload-id:
    type: int
    default: 3
    description: When the value corresponding to preload_id is reached, reload the value of preload_val.

  periph-idx:
    type: int
    enum:
      - 0
      - 1
    description: Index of the peripheral to be used.
                 It should be 0 for TIMER0 and 1 for TIMER1.

  comp0-val:
    type: int
    default: 0
    description: Trigger value of channel 0.

  comp1-val:
    type: int
    default: 0
    description: Trigger value of channel 1.

  comp2-val:
    type: int
    default: 0
    description: Trigger value of channel 2.

  preload-val:
    type: int
    default: 0
    description: Initial value for reloading.

  start-at-init:
    type: int
    default: 0
    description: Start the counter when initialized
```

## dts/bindings/counter/qualcomm,qc7xx-timer.yaml
```yaml
# SPDX-License-Identifier: Apache-2.0

description: Qualcomm's GP timer

compatible: "qualcomm,qc7xx-timer"

include: base.yaml

properties:
  reg:
    required: true

  clocks:
    required: true

  channels:
    type: int
    required: true
    description: Number of timer channels.

  clock-source:
    type: int
    default: 0
    description: Clock source of Timer.

  clock-div:
    type: int
    default: 0
    description: Timer prescaler.

  counter-mode:
    type: int
    default: 0
    description: Timer counter mode definition.

  preload-id:
    type: int
    default: 0
    description: When the value corresponding to preload_id is reached, reload the value of preload_val.

  comp0-val:
    type: int
    default: 0
    description: Trigger value of channel 0.

  comp1-val:
    type: int
    default: 0
    description: Trigger value of channel 1.

  comp2-val:
    type: int
    default: 0
    description: Trigger value of channel 2.

  preload-val:
    type: int
    default: 0
    description: Initial value for reloading.
```

## dts/bindings/cpu/qcom,qcc7xx-riscv.yaml
```yaml
# Copyright (c) 2026 Qualcomm Technologies, Inc. and/or its subsidiaries
# SPDX-License-Identifier: BSD-3-Clause

description: Qualcomm QCC7xx RISC-V CPU

compatible: "qcom,qcc7xx-riscv"

include: riscv-common.yaml

properties:
  riscv,pmpregions:
    type: int
    description: Number of PMP regions supported

  clocks:
    required: true
```

## dts/bindings/crypto/qcom,qcc74x-crypto.yaml
```yaml
# Copyright (c) 2026 Qualcomm Technologies, Inc. and/or its subsidiaries
# SPDX-License-Identifier: BSD-3-Clause

description: Qualcomm Opal family Crypto AES/SHA accelerator

compatible: "qcom,qcc74x-crypto"

include: base.yaml

properties:
  reg:
    required: true
```

## dts/bindings/crypto/qualcomm,qc7xx-crypto.yaml
```yaml
# SPDX-License-Identifier: Apache-2.0

description: Qualcomm Crypto SHA accelerator.

compatible: "qualcomm,qc7xx-crypto"

include: base.yaml

properties:
  reg:
    required: true
```

## dts/bindings/dac/qcom,qcc74x-dac.yaml
```yaml
# Copyright (c) 2022 Espressif Systems (Shanghai) Co., Ltd.
# SPDX-License-Identifier: Apache-2.0
#
# Copyright (c) 2026 Qualcomm Technologies, Inc. and/or its subsidiaries
# SPDX-License-Identifier: BSD-3-Clause
# Not a contribution.
description: |
    Qualcomm Opal family DAC controller.
    Two GPIO pads are capable of being DACs

    QCC74x pads
      - GPIO3 as DAC channel 1
      - GPIO2 as DAC channel 2

compatible: "qcom,qcc74x-dac"

include: [dac-controller.yaml, pinctrl-device.yaml]

properties:
  reg:
    required: true

  pinctrl-0:
    required: true

  pinctrl-names:
    required: true

  clk_div:
    type: int
    required: true
    description: DAC clock division ratio.
      Possible values are 8k, 16k, 32k, 512k.

  voltage_range:
    type: int
    description: DAC output voltage range select
      - DAC_VOLTAGE_RANGE_200_1200
      - DAC_VOLTAGE_RANGE_225_1425
      - DAC_VOLTAGE_RANGE_200_1800

  "#io-channel-cells":
    const: 1

io-channel-cells:
  - output
```

## dts/bindings/dma/qcom,qcc74x-dma.yaml
```yaml
# Copyright (c) 2026 Qualcomm Technologies, Inc. and/or its subsidiaries
# SPDX-License-Identifier: BSD-3-Clause

description: |
  Qualcomm Opal family DMA (Direct Memory Access) controller
  General Direct Memory Access (GDMA) is a feature that allows
  peripheral-to-memory, memory-to-peripheral, and memory-to-memory
  data transfer at a high speed.

compatible: "qcom,qcc74x-dma"

include: dma-controller.yaml

properties:
  reg:
    required: true

  interrupts:
    required: true

  dma-channels:
    required: true

  "#dma-cells":
    const: 3

dma-cells:
  - channel
  - slot
  - per_fifo_addr
```

## dts/bindings/dma/qualcomm,qc7xx-dma.yaml
```yaml
# SPDX-License-Identifier: Apache-2.0

description: |
  Qualcomm DMA (Direct Memory Access) Node

  General Direct Memory Access (GDMA) is a feature that allows
  peripheral-to-memory, memory-to-peripheral, and memory-to-memory
  data transfer at a high speed.

compatible: "qualcomm,qc7xx-dma"

include: dma-controller.yaml

properties:
  reg:
    required: true

  peripheral_name:
    type: string
    required: true

  interrupts:
    required: true

  dma-channels:
    required: true

  clocks:
    required: true

  "#dma-cells":
    const: 3

dma-cells:
  - channel
  - slot
  - per_fifo_addr
```
