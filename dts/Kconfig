## dts/bindings/ethernet/qcom,qcc74x-emac.yaml
```yaml
# Copyright (c) 2026 Qualcomm Technologies, Inc. and/or its subsidiaries
# SPDX-License-Identifier: BSD-3-Clause

description: Qualcomm Opal family Ethernet MAC controller

compatible: "qcom,qcc74x-emac"

include: [ethernet-controller.yaml, pinctrl-device.yaml]

properties:
  phy-handle:
    required: true

  ref-clk-output:
    type: int
    description: |
      ref-clk-output is used to configure whether the chip outputs the RMII clock.
      If it is set to 1, the chip provides a 50 MHz clock to the PHY. If it is set to 0,
      the PHY provides a 50 MHz clock to the chip.

  rx-clk-invert:
    type: int
    description: |
      rx_clk_invert is used to configure whether the inverted RX clock is used.
      If it is set to 1, the RX clock is inverted.
      If it is set to 0, the RX clock is not inverted.

  reset-gpios:
    type: phandle-array
    description: |
      Reset pin for the connected PHY or device.
      The reset pin is active low. If connected directly, the MCU pin should be
      configured as active low.
```

## dts/bindings/ethernet/qualcomm,qc7xx-emac.yaml
```yaml
# Copyright (c) 2026 Qualcomm Technologies, Inc. and/or its subsidiaries
# SPDX-License-Identifier: BSD-3-Clause

description: QC7XX Ethernet MAC driver

compatible: "qualcomm,qc7xx-emac"

include: [ethernet-controller.yaml, pinctrl-device.yaml]

properties:
  phy-handle:
    required: true

  peripheral_name:
    type: string
    required: true

  ref-clk-output:
    type: int
    description: |
      ref-clk-output is used to configure whether the chip outputs the RMII clock.
      If it is set to 1, the chip provides a 50 MHz clock to the PHY. If it is set to 0,
      the PHY provides a 50 MHz clock to the chip.

  rx-clk-invert:
    type: int
    description: |
      rx_clk_invert is used to configure whether the inverted RX clock is used.
      If it is set to 1, the RX clock is inverted.
      If it is set to 0, the RX clock is not inverted.
```

## dts/bindings/flash_controller/qcom,qcc74x-flash-controller.yaml
```yaml
# Copyright (c) 2026 Qualcomm Technologies, Inc. and/or its subsidiaries
# SPDX-License-Identifier: BSD-3-Clause

description: Qualcomm Opal family flash controller

compatible: "qcom,qcc74x-flash-controller"

include: flash-controller.yaml

properties:
  clocks:
    required: true

  flash-clk-div:
    type: int
    default: 0
    description: Flash clock divider value.
```

## dts/bindings/flash_controller/qualcomm,qc7xx-flash-controller.yaml
```yaml
# SPDX-License-Identifier: Apache-2.0

description: Qualcomm flash controller

compatible: "qualcomm,qc7xx-flash-controller"

include: flash-controller.yaml
```

## dts/bindings/gpio/qcom,qcc74x-gpio.yaml
```yaml
# Copyright (c) 2026 Qualcomm Technologies, Inc. and/or its subsidiaries
# SPDX-License-Identifier: BSD-3-Clause

description: Qualcomm Opal family GPIO controller

compatible: "qcom,qcc74x-gpio"

include: [gpio-controller.yaml, base.yaml]

properties:
  reg:
    required: true

  interrupts:
    required: true

  "#gpio-cells":
    const: 2

  "#qcom,pin-cells":
    type: int
    const: 2

gpio-cells:
  - pin
  - flags

qcom,pin-cells:
  - pin
  - peripheral
```

## dts/bindings/gpio/qualcomm,qc7xx-gpio.yaml
```yaml
# SPDX-License-Identifier: Apache-2.0

description: Qualcomm GPIO controller

compatible: "qualcomm,qc7xx-gpio"

include: [gpio-controller.yaml, base.yaml]

properties:
  reg:
    required: true

  "#gpio-cells":
    const: 2

gpio-cells:
  - pin
  - flags
```
