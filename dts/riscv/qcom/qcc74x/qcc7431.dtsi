/*
 * Copyright (c) 2026 Qualcomm Technologies, Inc. and/or its subsidiaries
 * SPDX-License-Identifier: BSD-3-Clause
 */

#include <qcom/qcc74x/qcc743i.dtsi>

/ {
	chosen {
		zephyr,sram = &sram0;
	};
};
