/*
 * Copyright (c) 2026 Qualcomm Technologies, Inc. and/or its subsidiaries
 * SPDX-License-Identifier: BSD-3-Clause
 */

/dts-v1/;

#include <qcom/qcc74x/qcc744i.dtsi>

&soc {
		usb: usb@20072000 {
			compatible = "qcom,qcc74x-udc";
			reg = <0x20072000 0x1000>;
			interrupts = <USB_IRQn IRQ_DEFAULT_PRIORITY 0>;
			interrupt-parent = <&intc>;
			clocks = <&clock0 QC7XX_PERIPHERAL_USB20 QC7XX_USB20_CLK_WIFIPLL>;
			resets = <&reset QC7XX_RESET_EXT_USB>;
			num-bidir-endpoints = <5>;
			maximum-speed = "high-speed";
			status = "disabled";
		};
};
