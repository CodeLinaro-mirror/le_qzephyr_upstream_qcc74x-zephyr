## dts/bindings/pinctrl/qcom,qcc74x-pinctrl.yaml
```yaml
# Copyright (c) 2021, Gerson Fernando Budke <nandojve@gmail.com>
# SPDX-License-Identifier: Apache-2.0
#
# Copyright (c) 2026 Qualcomm Technologies, Inc. and/or its subsidiaries
# SPDX-License-Identifier: BSD-3-Clause
# Not a contribution.

description: Qualcomm Opal family pin control

compatible: "qcom,qcc74x-pinctrl"

include: base.yaml

child-binding:
  description: |
    Qualcomm QCC74x family pin controller pin configuration nodes. Each node is composed
    by one or more groups, each defining the configuration for a set of pins.

  child-binding:
    description: |
      Qualcomm QCC74x family pin controller pin configuration group. Each group contains
      a list of pins sharing the same set of properties. Example:
      uart0_default: uart0_default {
        group1 {
          /* configure to uart0 function, pin 22 as UART_RX
             pin 21 as UART_TX */
          pinmux = <UART0_TXD_GPIO21>,
                   <UART0_RXD_GPIO22>;
          bias-pull-up;
          input-schmitt-enable;
        };
      };
      The list of supported standard properties:
      - bias-high-impedance: Disable pull-up/down (default behavior, not
        required).
      - bias-pull-up: Enable pull-up resistor.
      - bias-pull-down: Enable pull-down resistor.
      - input-enable: Enable GPIO as input.
      - input-schmitt-enable: Enable Schimitt Trigger when GPIO is Input.
      - output-enable: Enable GPIO as output.

      Note that bias options are mutually exclusive. It is the same with GPIO
      input/output enable options.

    include:
      - name: pincfg-node.yaml
        property-allowlist:
          - bias-high-impedance
          - bias-pull-down
          - bias-pull-up
          - input-enable
          - input-schmitt-enable
          - output-enable
          - output-high
          - output-low


    properties:
      pinmux:
        required: true
        type: array
        description: |
          An array of pins sharing the same group properties. The pins should be
          defined using the QCOM_PINMUX utility macro that encode all the pin
          route matrix.
      drive-strength:
        type: int
        default: 0
        enum:
          - 0     # Default value, lower strength, 8mA
          - 1     # 9.6mA
          - 2     # 11.2mA
          - 3     # highest strength, 12.8mA
        description: |
          Pin drive strength. It tunes pin max current where 0 means lower
          value, which is the default, and 3 represents max drive strength.
      ir-enable:
        type: boolean
        description: |
          If enabled. Pin will be selected for IR (Infrared) function.
```

## dts/bindings/pinctrl/qualcomm,qc7xx-pinctrl.yaml
```yaml
# SPDX-License-Identifier: Apache-2.0

description: |
    Qualcomm's pin controller is in charge of controlling pin configurations, pin
    functionalities and pin properties as defined by pin states. In its turn, pin
    states are composed by groups of pre-defined pin muxing definitions and user
    provided pin properties.
compatible: "qualcomm,qc7xx-pinctrl"

include: base.yaml

child-binding:
  description: |
    Qualcomm pin controller pin configuration state nodes.
  child-binding:
    description:
      Qualcomm pin controller pin configuration group.

    include:
      - name: pincfg-node.yaml
        property-allowlist:
          - bias-disable
          - bias-pull-down
          - bias-pull-up
          - drive-push-pull
          - drive-open-drain
          - drive-strength
          - input-enable
          - input-schmitt-enable
          - output-enable
          - output-high
          - output-low

    properties:
      pinmux:
        required: true
        type: array
        description: |
          Each array element represents pin muxing information of an individual
          pin. The array elements are pre-declared macros taken from Qualcomm's
          HAL.
```

## dts/bindings/pwm/qcom,qcc74x-pwm.yaml
```yaml
# Copyright (c) 2026 Qualcomm Technologies, Inc. and/or its subsidiaries
# SPDX-License-Identifier: BSD-3-Clause

description: Qualcomm Opal family PWM controller

compatible: "qcom,qcc74x-pwm"

include: [pwm-controller.yaml, pinctrl-device.yaml, reset-device.yaml, base.yaml]

properties:
  reg:
    required: true

  interrupts:
    required: true

  clocks:
    required: true

  resets:
    required: true

  divider:
    type: int
    required: true
    description: 16 bit Clock divider, up to 65535 divisions

  pinctrl-0:
    required: true

  "#pwm-cells":
    const: 3

pwm-cells:
  - channel
  - period
  - flags
```

## dts/bindings/reset/qcom,qcc74x-reset.yaml
```yaml
# Copyright (c) 2026 Qualcomm Technologies, Inc. and/or its subsidiaries
# SPDX-License-Identifier: BSD-3-Clause

description: Qualcomm Opal family reset controller

compatible: "qcom,qcc74x-reset"

include: [reset-controller.yaml, base.yaml]

properties:
  "#reset-cells":
    const: 1

reset-cells:
  - id
```

## dts/bindings/rng/qcom,qcc74x-trng.yaml
```yaml
# Copyright (c) 2026 Qualcomm Technologies, Inc. and/or its subsidiaries
# SPDX-License-Identifier: BSD-3-Clause

description: |
    Qualcomm Opal family TRNG (True Random Number Generator).

compatible: "qcom,qcc74x-trng"

include: base.yaml

properties:
  reg:
    required: true
```

## dts/bindings/rng/qualcomm,qc7xx-trng.yaml
```yaml
# SPDX-License-Identifier: Apache-2.0

description: |
    Qualcomm QC7XX TRNG (True Random Number Generator).

compatible: "qualcomm,qc7xx-trng"

include: base.yaml

properties:
  reg:
    required: true
```

## dts/bindings/rtc/qcom,qcc74x-rtc.yaml
```yaml
# Copyright (c) 2026 Qualcomm Technologies, Inc. and/or its subsidiaries
# SPDX-License-Identifier: BSD-3-Clause

description: Qualcomm Opal family RTC controller

compatible: "qcom,qcc74x-rtc"

include: [uart-controller.yaml, pinctrl-device.yaml]

properties:
  reg:
    required: true
```
