## dts/bindings/i2c/qcom,qcc74x-i2c.yaml
```yaml
# Copyright (c) 2026 Qualcomm Technologies, Inc. and/or its subsidiaries
# SPDX-License-Identifier: BSD-3-Clause

description: Qualcomm Opal family I2C controller

compatible: "qcom,qcc74x-i2c"

include: [i2c-controller.yaml, pinctrl-device.yaml, reset-device.yaml]

properties:
  reg:
    required: true

  interrupts:
    required: true

  pinctrl-0:
    required: true

  pinctrl-names:
    required: true

  clock-frequency:
    description: Initial clock frequency in Hz
    required: true
    type: int
    default: 100000
    enum:
      - 100000
      - 400000
      - 1000000

  clocks:
    required: true

  resets:
    required: true

  dmas:
    description: |
      DMA channels for TX and RX operations.
      First cell specifies the channel number,
      Second cell specifies the slot
      Third cell specifies the peripheral FIFO address.

  dma-names:
    description: |
      Should be "tx" and "rx" for transmit and receive DMA channels.
```

## dts/bindings/i2c/qualcomm,qc7xx-i2c.yaml
```yaml
# Copyright (c) 2026 Qualcomm Technologies, Inc. and/or its subsidiaries
# SPDX-License-Identifier: BSD-3-Clause

description: QUALCOMM I2C

compatible: "qualcomm,qc7xx-i2c"

include: [i2c-controller.yaml, reset-device.yaml, pinctrl-device.yaml]

properties:
  reg:
    required: true

  interrupts:
    required: true

  clocks:
    required: true

  pinctrl-0:
    required: true

  pinctrl-names:
    required: true
```

## dts/bindings/i2s/qcom,qcc74x-i2s.yaml
```yaml
# Copyright (c) 2026 Qualcomm Technologies, Inc. and/or its subsidiaries
# SPDX-License-Identifier: BSD-3-Clause

description: Qualcomm Opal family I2S controller

compatible: "qcom,qcc74x-i2s"

include: [i2s-controller.yaml, pinctrl-device.yaml, reset-device.yaml]

properties:
  reg:
    required: true

  pinctrl-0:
    required: true

  pinctrl-names:
    required: true

  interrupts:
    required: true

  interrupt-parent:
    required: true

  resets:
    required: true

  dmas:
    required: true
    description: |
      TX & RX dma specifiers.  Each specifier will have a phandle
      reference to the dma controller, the channel number, peripheral
      trigger source, and peripheral fifo address. The channel number
      is arbitrary but must not be reused. The number of channels
      available is device dependent.

      For example dmas for TX and RX may look like
      dmas = <&dma 0  DMA_REQUEST_I2S_TX  DMA_ADDR_I2S_TDR>,
             <&dma 1  DMA_REQUEST_I2S_RX  DMA_ADDR_I2S_RDR>;

  dma-names:
    required: true
    description: |
      This should be "tx" and "rx" and should match the order given for
      dmas.

      For example using the example dmas, an example dma-names would be
         dma-names = "tx", "rx";

  diclk:
    required: true
    type: int
    default: 0
    description: |
      Property indicating if DI pin will serve as DI input or ref clk output.

  doclk:
    required: true
    type: int
    default: 0
    description: |
      Property indicating if DO pin will serve as DO output or ref clk output.

  div:
    required: true
    type: int
    default: 0
    description: |
      Value of the clock divider. Should be less or equal to 0x3F.

  slave-mode:
    type: boolean
    description: |
      If present, the I2S controller operates in slave mode: BCLK and LRCLK
      are driven by an external master (e.g. a codec in master mode).
      If absent (default), the controller operates in master mode and
      generates BCLK and LRCLK itself.
```

## dts/bindings/i2s/qualcomm,qc7xx-i2s.yaml
```yaml
# Copyright (c) 2026 Qualcomm Technologies, Inc. and/or its subsidiaries
# SPDX-License-Identifier: Apache-2.0

description: QUALCOMM I2S

compatible: "qualcomm,qc7xx-i2s"

include: [i2s-controller.yaml, pinctrl-device.yaml]

properties:
  reg:
    required: true

  peripheral_name:
    type: string
    required: true

  pinctrl-0:
    required: true

  pinctrl-names:
    required: true

  clocks:
    required: true

  interrupts:
    required: true

  interrupt-parent:
    required: true

  dmas:
    required: true
    description: |
      TX & RX dma specifiers.  Each specifier will have a phandle
      reference to the dma controller, the channel number, peripheral
      trigger source, and peripheral fifo address. The channel number
      is arbitrary but must not be reused. The number of channels
      available is device dependent.

      For example dmas for TX and RX may look like
      dmas = <&dma 0  DMA_REQUEST_I2S_TX  DMA_ADDR_I2S_TDR>,
             <&dma 1  DMA_REQUEST_I2S_RX  DMA_ADDR_I2S_RDR>;

  dma-names:
    required: true
    description: |
      This should be "tx" and "rx" and should match the order given for
      dmas.

      For example using the example dmas, an example dma-names would be
         dma-names = "tx", "rx";

  "#clock-cells":
    type: int
    const: 0

  "#sound-dai-cells":
    type: int
    const: 0

  format:
    type: string
    required: false
    enum: ["i2s", "left_j", "right_j", "pcm_a", "pcm_b"]
    description: Audio format used by the I2S interface

  bit-clock-direction:
    type: string
    required: false
    enum: ["input", "output"]
    description: Direction of the bit clock

  frame-clock-direction:
    type: string
    required: false
    enum: ["input", "output"]
    description: Direction of the frame clock

  slot-width:
    type: int
    required: false
    enum: [8, 16, 20, 24, 32]
    description: Width of each audio slot in bits

  bit-clock-master:
    type: boolean
    required: false
    description: |
      Whether the I2S interface is the bit clock master. If true,
      the I2S interface generates the bit clock (BCLK). If false,
      it uses an external bit clock.

  frame-clock-master:
    type: boolean
    required: false
    description: |
      Whether the I2S interface is the frame clock master. If true,
      the I2S interface generates the frame clock (LRCK/WS). If false,
      it uses an external frame clock.
```

## dts/bindings/ieee802154/qcom,qcc74x-ieee802154.yaml
```yaml
# Device tree binding for QCC74x IEEE 802.15.4 radio
#
# Copyright (c) 2026 Qualcomm Technologies, Inc. and/or its subsidiaries
# SPDX-License-Identifier: BSD-3-Clause

description: Qualcomm QCC74x IEEE 802.15.4 radio

compatible: "qcom,qcc74x-ieee802154"

include: base.yaml

properties:
  channel:
    type: int
    default: 11
    description: Default IEEE 802.15.4 channel (11-26)

  tx-power:
    type: int
    default: 10
    description: Default TX power in dBm (0-14)
```

## dts/bindings/interrupt-controller/qcom,qcc74x-intc.yaml
```yaml
# Copyright (c) 2026 Qualcomm Technologies, Inc. and/or its subsidiaries
# SPDX-License-Identifier: BSD-3-Clause

description: Qualcomm Opal family Interrupt controller

compatible: "qcom,qcc74x-intc"

include: [interrupt-controller.yaml, base.yaml]

properties:
  reg:
    required: true

  "#interrupt-cells":
    const: 3

interrupt-cells:
  - irq
  - priority
  - flags
```

## dts/bindings/interrupt-controller/qualcomm,qc7xx-intc.yaml
```yaml
# SPDX-License-Identifier: Apache-2.0

description: Qualcomm Interrupt controller
compatible: "qualcomm,qc7xx-intc"

include: [interrupt-controller.yaml, base.yaml]

properties:
  reg:
    required: true

  "#interrupt-cells":
    const: 3

interrupt-cells:
  - irq
  - priority
  - flags
```

## dts/bindings/ipm/qcom,qcc74x-ipc.yaml
```yaml
# Copyright (c) 2026 Qualcomm Technologies, Inc. and/or its subsidiaries
# SPDX-License-Identifier: BSD-3-Clause

description: Qualcomm Opal IPC doorbell for inter-processor signaling

compatible: "qcom,qcc74x-ipc"

include: base.yaml

properties:
  reg:
    required: true
  interrupts:
    required: true
```

## dts/bindings/ipm/qualcomm,qc7xx-ipc.yaml
```yaml
# SPDX-License-Identifier: Apache-2.0

description: Qualcomm QC7xx IPC doorbell for inter-processor signaling

compatible: "qualcomm,qc7xx-ipc"

include: base.yaml

properties:
  reg:
    required: true
  interrupts:
    required: true
```

## dts/bindings/ir/qcom,qcc74x-ir.yaml
```yaml
# Copyright (c) 2026 Qualcomm Technologies, Inc. and/or its subsidiaries
# SPDX-License-Identifier: Apache-2.0

# Contains code under the following license:
#
# Not a contribution.
#
# Copyright (c) Zephyr Project members and individual contributors.
# SPDX-License-Identifier: Apache-2.0

description: Qualcomm Opal family IR (infrared) controller

compatible: "qcom,qcc74x-ir"

include: [pinctrl-device.yaml, base.yaml]

properties:

  reg:
    required: true

  divider:
    type: int
    required: true
    description: 8 bit Clock divider

  pinctrl-0:
    required: true

  pinctrl-names:
    required: true

  rx_mode:
    type: string
    required: true
    enum:
      - IR_RX_NEC
      - IR_RX_RC5
      - IR_RX_SWM
    description: RX mode select, use SWM for other protocols than NEC or RC5.

  input_inverse:
    type: boolean
    description: Enable signal of input inverse

  deglitch_enable:
    type: boolean
    description: Enable signal of rx input de-glitch function

  deglitch_cnt:
    type: int
    default: 0
    description: De-glitch function cycle count

  data_threshold:
    type: int
    default: 0
    description: Pulse width threshold for logic 0/1 detection.

  end_threshold:
    type: int
    default: 0
    description: Pulse width threshold to trigger end condition.

  fifo_threshold:
    type: int
    default: 0
    description: RX FIFO threshold.
```

## dts/bindings/mdio/qcom,qcc74x-mdio.yaml
```yaml
# Copyright (c) 2026 Qualcomm Technologies, Inc. and/or its subsidiaries
# SPDX-License-Identifier: BSD-3-Clause

description: Qualcomm Opal family MDIO controller

compatible: "qcom,qcc74x-mdio"

include: [mdio-controller.yaml, pinctrl-device.yaml]

properties:
  pinctrl-0:
    required: true

  pinctrl-names:
    required: true

  clocks:
    required: true

  clk_div:
    type: int
    required: true
```

## dts/bindings/mdio/qualcomm,qc7xx-mdio.yaml
```yaml
# SPDX-License-Identifier: Apache-2.0

description: Qualcomm MDIO controller

compatible: "qualcomm,qc7xx-mdio"

include: [mdio-controller.yaml, pinctrl-device.yaml]

properties:
  pinctrl-0:
    required: true

  pinctrl-names:
    required: true

  clocks:
    required: true

  clk_div:
    type: int
    required: true
```

## dts/bindings/memory/qc7xx-psram.yaml
```yaml
# Copyright (c) 2026 Qualcomm Technologies, Inc. and/or its subsidiaries
# SPDX-License-Identifier: BSD-3-Clause

description: Generic QC7XX PSRAM memory region

compatible: "qc7xx-psram"

include: base.yaml

properties:
  clocks:
    required: true

  psram-clk-div:
    type: int
    default: 0
    description: PSRAM clock divider value.
```

## dts/bindings/mfd/qcom,qcc74x-rcu.yaml
```yaml
# Copyright (c) 2026 Qualcomm Technologies, Inc. and/or its subsidiaries
# SPDX-License-Identifier: BSD-3-Clause

description: |
  Qualcomm Opal family Reset and Clock Unit (RCU) if a multi-function peripheral
  in charge of reset control (RCTL) and clock control (CCTL) for all SoC
  peripherals. Child nodes are used to represent each functional block.

compatible: "qcom,qcc74x-rcu"

include: base.yaml

properties:
  reg:
    required: true
```

## dts/bindings/mfd/qualcomm,qc7xx-rcu.yaml
```yaml
# SPDX-License-Identifier: Apache-2.0

description: |
  Qualcomm Reset and Clock Unit (RCU) if a multi-function peripheral in
  charge of reset control (RCTL) and clock control (CCTL) for all SoC
  peripherals. Child nodes are used to represent each functional block.

compatible: "qualcomm,qc7xx-rcu"

include: base.yaml

properties:
  reg:
    required: true
```

## dts/bindings/mipi-dbi/qcom,qcc74x-mipi-dbi.yaml
```yaml
# Copyright (c) 2026 Qualcomm Technologies, Inc. and/or its subsidiaries
# SPDX-License-Identifier: Apache-2.0

# Contains code under the following license:
#
# Not a contribution.
#
# Copyright (c) Zephyr Project members and individual contributors.
# SPDX-License-Identifier: Apache-2.0

description: Qualcomm Opal family DBI display controller

compatible: "qcom,qcc74x-mipi-dbi"

include: [mipi-dbi-controller.yaml, pinctrl-device.yaml, reset-device.yaml]

properties:
  reg:
    required: true

  pinctrl-0:
    required: true

  pinctrl-names:
    required: true

  clocks:
    required: true

  interrupts:
    required: true

  interrupt-parent:
    required: true

  reset-gpios:
    type: phandle-array
    description: |
      Reset GPIO pin. Used to reset the display during initialization.

  mipi-mode:
    type: string
    description: |
      MIPI DBI mode in use. These definitions should match those in
      dt-bindings/mipi_dbi/mipi_dbi.h
    enum:
      - "MIPI_DBI_MODE_SPI_3WIRE"
      - "MIPI_DBI_MODE_SPI_4WIRE"
      - "MIPI_DBI_MODE_8080_BUS_8_BIT"

  dmas:
    description: |
      TX & RX dma specifiers.  Each specifier will have a phandle
      reference to the dma controller, the channel number, peripheral
      trigger source, and peripheral fifo address. The channel number
      is arbitrary but must not be reused. The number of channels
      available is device dependent.

      For example dmas for TX and RX may look like
      dmas = <&dma 3  DMA_REQUEST_DBI_TX  DMA_ADDR_DBI_TDR>;

  resets:
    required: true
```

## dts/bindings/mipi-dbi/qualcomm,qc7xx-mipi-dbi.yaml
```yaml
# SPDX-License-Identifier: Apache-2.0

description:
  Qualcomm QC7XX DBI display controller

compatible: "qualcomm,qc7xx-mipi-dbi"

include: [mipi-dbi-controller.yaml, pinctrl-device.yaml]

properties:
  reg:
    required: true

  peripheral_name:
    type: string
    required: true

  pinctrl-0:
    required: true

  pinctrl-names:
    required: true

  clocks:
    required: true

  interrupts:
    required: true

  interrupt-parent:
    required: true

  reset-gpios:
    type: phandle-array
    description: |
      Reset GPIO pin. Used to reset the display during initialization.

  mipi-mode:
    type: string
    description: |
      MIPI DBI mode in use. These definitions should match those in
      dt-bindings/mipi_dbi/mipi_dbi.h
    enum:
      - "MIPI_DBI_MODE_SPI_3WIRE"
      - "MIPI_DBI_MODE_SPI_4WIRE"
      - "MIPI_DBI_MODE_8080_BUS_8_BIT"

  dmas:
    description: |
      TX & RX dma specifiers.  Each specifier will have a phandle
      reference to the dma controller, the channel number, peripheral
      trigger source, and peripheral fifo address. The channel number
      is arbitrary but must not be reused. The number of channels
      available is device dependent.

      For example dmas for TX and RX may look like
      dmas = <&dma 3  DMA_REQUEST_DBI_TX  DMA_ADDR_DBI_TDR>;
```
