## soc/qcom/qcc74x/Kconfig
```kconfig
# Copyright (c) Qualcomm Technologies, Inc. and/or its subsidiaries
# SPDX-License-Identifier: BSD-3-Clause

config SOC_SERIES_QCC74X
	select RISCV
	select RISCV_PRIVILEGED
	select RISCV_HAS_CLIC
	select RISCV_SOC_CONTEXT_SAVE if !QCC74X_WIFI_PERF_MODE
	select INCLUDE_RESET_VECTOR
	select RISCV_SOC_HAS_GP_RELATIVE_ADDRESSING
	select DYNAMIC_INTERRUPTS
	select SHARED_INTERRUPTS
	select SOC_LATE_INIT_HOOK
	select CLOCK_CONTROL
	select ARCH_HAS_NOCACHE_MEMORY_SUPPORT
	select NOCACHE_MEMORY

	select RISCV_ISA_RV32I
	select RISCV_ISA_EXT_A
	select RISCV_ISA_EXT_M
	select RISCV_ISA_EXT_F
	select RISCV_ISA_EXT_C
	select RISCV_ISA_EXT_ZICSR
	select RISCV_ISA_EXT_ZIFENCEI
	select HAS_QCOM_QCC74X_HAL
	select CPU_HAS_FPU
	select CPU_HAS_DCACHE
	select CPU_HAS_ICACHE
	select RISCV_PMP
	select FPU
	select MULTI_HEAP
	select SYS_HEAP_RUNTIME_STATS
	select HAS_PM
	select HAS_POWEROFF
	select SOC_EARLY_INIT_HOOK if POWEROFF

if SOC_SERIES_QCC74X

config QCC74X_SEC_PKA
	bool "QCC74x public-key accelerator"
	default n
	help
	  Enable the QCC74x security-engine PKA and its ECDSA/ECDH HAL API.

config QCC74X_COREDUMP_FULL_MEMORY
	bool "Dump QCC74x physical RAM and tracked PSRAM allocations"
	depends on DEBUG_COREDUMP_MEMORY_DUMP_LINKER_RAM
	depends on PSRAM && PSRAM_LENGTH > 0
	default n
	help
	  Replace Zephyr's default linker-RAM coredump list with QCC74x OCRAM,
	  Wi-Fi WRAM, HBN RAM, static PSRAM, and active PSRAM allocations tracked
	  by the SoC multi-heap allocator. This is an opt-in diagnostic profile.

config QCC74X_COREDUMP_PSRAM_LEDGER_MAX_ENTRIES
	int "Maximum tracked PSRAM allocations in a coredump"
	depends on QCC74X_COREDUMP_FULL_MEMORY
	range 1 256
	default 64
	help
	  Fixed number of active PSRAM allocation records retained by the SoC
	  allocator. An overflow marker is retained if PSRAM coverage is incomplete.

choice QCC74X_COREDUMP_SERIAL_PSRAM_MODE
	prompt "QCC74x serial coredump PSRAM coverage"
	depends on QCC74X_COREDUMP_FULL_MEMORY
	depends on DEBUG_COREDUMP_MEMORY_DUMP_LINKER_RAM
	depends on DEBUG_COREDUMP_BACKEND_LOGGING || DEBUG_COREDUMP_BACKEND_OTHER
	depends on PSRAM && PSRAM_LENGTH > 0
	default QCC74X_COREDUMP_SERIAL_FULL_PSRAM
	help
	  Select the PSRAM coverage used by the QCC74x serial coredump profiles.
	  Both the standard logging backend and the QCC74x custom safe-serial
	  backend use this choice. Flash coredump retains its tracked-PSRAM policy.

config QCC74X_COREDUMP_SERIAL_FULL_PSRAM
	bool "Dump the complete physical PSRAM window"
	help
	  Emit the full DTS PSRAM range to the selected serial coredump backend.
	  This is a diagnostic profile and can expose allocated, free, and stale
	  data.

config QCC74X_COREDUMP_SERIAL_TRACKED_PSRAM
	bool "Dump static and tracked active PSRAM"
	help
	  Emit the linker-placed static PSRAM prefix plus active allocations
	  recorded by the QCC74x SoC multi-heap ledger.

endchoice

config QCC74X_HBN_SHELL
	bool "Enable QCC74X HBN shell command"
	depends on POWEROFF && SHELL
	default n
	help
	  Enable the QCC74X-specific HBN shell command. The command uses the
	  Zephyr system-off API and is available to any shell-enabled
	  application built for QCC74X; it is not tied to a particular sample.

	  The command provides HBN wake information query and clear operations.
	  QCC74X Zephyr HBN always uses HBN0 and supports RTC or ACOMP edge wake.

config ANTI_ROLLBACK
	bool "Enable QCC74X application anti-rollback support"
	default n
	help
	  Embed an application anti-rollback version in the image and provide
	  APIs to read and advance the corresponding eFuse value. The eFuse is
	  irreversible: call qcc74x_anti_rollback_version_commit() only after a
	  new image has completed its product-specific health checks.

config APP_ANTI_ROLLBACK_VER
	int "QCC74X application anti-rollback version"
	depends on ANTI_ROLLBACK
	default 0
	range 0 128
	help
	  Version embedded in the firmware image. Version zero is an
	  unprovisioned image version and cannot be committed to eFuse. Use a
	  monotonically increasing value in the range 1 through 128 for a
	  production image that will be committed.

config QCC74X_NET_PKT_PSRAM
	bool "Place Zephyr fixed network packet pools in PSRAM"
	depends on NETWORKING && WIFI_QCC74X && PSRAM && NET_BUF_FIXED_DATA_SIZE
	depends on QCC74X_PM_PDS1 || PSRAM_COPY_CODE
	default n
	help
	  Place the RX/TX packet slabs, buffer descriptors and fixed payload
	  arrays from net_pkt.c in PSRAM instead of internal SRAM. PDS1 retains
	  these data pools; code and stacks remain in internal memory. This
	  does not enable the Wi-Fi high-performance profile or PSRAM code copy.
	  The PSRAM controller must be initialized before kernel slab setup.

config QCC74X_WIFI_PERF_MODE
	bool "WiFi high-performance mode (disables ECLIC interrupt-level context save)"
	default n
	help
	  Enable in WiFi-throughput builds only. Without this option,
	  RISCV_SOC_CONTEXT_SAVE is selected, which adds two function calls
	  (__soc_save_context / __soc_restore_context) to every trap entry/exit.

config QCC74X_PM_DIAGNOSTICS
	bool "Enable QCC74X PM diagnostics"
	depends on PM
	default n
	help
	  Enable lightweight System PM diagnostics for the QCC74X shallow
	  suspend-to-idle path and the PDS15 suspend-to-ram flow. This is
	  intended for bring-up and validation of QCC74X PM behavior.

config LPAPP
	bool
	help
	  Internal SDK compatibility switch used by the QCC74X linker script
	  and HAL low-power code for LPFW/PDS15 layout.

choice QCC74X_PM_LPFW_MODE
	prompt "QCC74X LPFW deep-sleep mode"
	optional
	depends on QCC74X_PM_LPFW_CAPABLE
	help
	  Select one compile-time deep-sleep mode, or leave both disabled.
	  Pair the selection with CPU power states and memory configuration
	  in devicetree. PDS15 firmware must not use PSRAM.
	  Leave this choice disabled for ordinary firmware. Enabling PM or
	  selecting a board does not automatically enable LPFW deep sleep.

config QCC74X_PM_PDS15
	bool "Enable QCC74X PDS15 suspend-to-ram path"
	depends on !PSRAM
	select QCC74X_PM_LPFW
	help
	  Use suspend-to-ram substate 15 without PSRAM retention.

config QCC74X_PM_PDS1
	bool "Enable QCC74X PDS1 PSRAM retention"
	depends on PSRAM
	depends on PSRAM_LENGTH = 0x400000 || PSRAM_LENGTH = 0x800000 || PSRAM_LENGTH = 0x1000000
	select QCC74X_PM_LPFW
	help
	  Use suspend-to-ram substate 1 with 4, 8 or 16 MiB Winbond x8 PSRAM data and
	  heap retention, including configurations that execute copied code from PSRAM. Stacks
	  must remain in internal memory. This does not select a Wi-Fi performance
	  profile or change the PSRAM code-copy selection.
	  The devicetree CPU power states must include substate 1. UART is
	  unavailable while asleep; arrange a wake source before entry.

endchoice

config QCC74X_PDS1_DEBUG_TRACE
	bool "PDS1 diagnostic breadcrumbs and preserved JTAG pins"
	depends on QCC74X_PM_PDS1
	help
	  Preserve GPIO0..3 during APP low-power GPIO preparation and record
	  uncached stage markers for debugger inspection. Not for power
	  measurements or applications using these pins for GPIO wake.

config QCC74X_PM_LPFW_CAPABLE
	bool
	default y
	depends on PM && !RISCV_MACHINE_TIMER
	depends on PM_DEVICE && PM_DEVICE_SYSTEM_MANAGED
	depends on PM_POLICY_CUSTOM && UART_QCC74X
	depends on !SMP && !PMP_STACK_GUARD && !ZERO_LATENCY_IRQS
	depends on !LOG_MODE_IMMEDIATE && !LOG_MODE_MINIMAL
	depends on !SHELL_BACKEND_SERIAL_CHECK_DTR
	depends on !SHELL_BACKEND_SERIAL_API_ASYNC

config QCC74X_PM_LPFW
	bool
	select LPAPP
	help
	  Shared LPFW backend for the mutually exclusive PDS1 and PDS15
	  modes, including the QCC74X-local system timer and PM policy.

	  UARTs are suspended and resumed only by System-Managed Device PM.
	  Keep UART output out of the system suspend/resume interval. Runtime
	  PM enabled UARTs and active async transfers reject deep sleep. UART RX is
	  not a wake source; input during sleep may be lost. System PM traverses
	  all devices, so audit any other enabled device PM callbacks.

config QCC74X_PM_PDS15_SYSTEM_TIMER
	bool "Use QCC74X LPFW-aware system timer"
	depends on QCC74X_PM_LPFW && !RISCV_MACHINE_TIMER
	default y
	select TICKLESS_CAPABLE
	select TIMER_HAS_64BIT_CYCLE_COUNTER
	help
	  Use a QCC74X-local RISC-V machine timer implementation that can
	  rebase Zephyr kernel ticks after PDS1/PDS15 without patching the generic
	  RISC-V timer driver.

config QCC74X_PM_PDS15_DEBUG_LOG
	bool "Enable verbose QCC74X PDS15 bring-up logs"
	depends on QCC74X_PM_PDS15 && QCC74X_PM_DIAGNOSTICS
	depends on !PM_DEVICE_SYSTEM_MANAGED
	default n
	help
	  Enable detailed PDS15/LPFW/Wi-Fi resume logging diagnostics used
	  during bring-up and bench validation. Production builds should keep
	  this disabled so the SoC PM path stays quiet by default.

module = QCC74X_PM_PDS15
module-str = QCC74X PDS15 PM
source "subsys/logging/Kconfig.template.log_config"

config QCC74X_PM_PDS15_AUTO_INIT
	bool "Automatically initialize QCC74X LPFW at boot"
	depends on QCC74X_PM_LPFW
	default y
	help
	  Initialize the vendor LPFW handoff during Zephyr application
	  init so the automatic low-power policy can be enabled without a
	  separate LPFW shell initialization step.

config QCC74X_PM_PDS15_POLICY
	bool
	depends on QCC74X_PM_LPFW && PM_POLICY_CUSTOM
	default y
	help
	  Use a QCC74X-specific Zephyr PM policy that preserves the default
	  residency, device-busy, and policy-lock behavior, but only selects
	  the selected PDS1 or PDS15 state when the QCC74X automatic low-power
	  gate permits suspend-to-ram substate 1 or 15, respectively.

config QCC74X_PM_PDS15_BLE
	bool "Enable QCC74X PDS15 BLE controller low power"
	depends on QCC74X_PM_PDS15 && BT
	default n
	help
	  Integrate the BLE controller sleep API (btble_controller_sleep /
	  btble_controller_sleep_restore) into the PDS15 flow.

	  When enabled:
	  - PDS15 entry queries the BLE controller for its desired sleep
	    duration and takes the minimum of BLE/WiFi/RTOS timeouts.
	  - BLE activity (btble_controller_sleep() < 0) blocks PDS15 entry
	    and falls back to WFI.
	  - The BLE controller is restored via btble_controller_sleep_restore()
	    in the PDS15 wake path.
	  - A BLE crash guard detects overslept wake cycles and performs a
	    GLB soft reset of the BTDM domain.

config QCC74X_PM_PDS15_BLE_CRASH_TOLERANCE_US
	int "BLE crash detection tolerance (microseconds)"
	depends on QCC74X_PM_PDS15_BLE
	default 50000
	help
	  Allow elapsed_us to exceed the BLE-requested wake time by up to
	  this many microseconds before triggering BLE crash recovery
	  (GLB BTDM soft reset). Reduce for stricter testing, increase for
	  noisy hardware environments.

endif # SOC_SERIES_QCC74X
```

## soc/qcom/qcc74x/Kconfig.defconfig
```kconfig
# Copyright (c) 2026 Qualcomm Technologies, Inc. and/or its subsidiaries
# SPDX-License-Identifier: BSD-3-Clause

if SOC_SERIES_QCC74X

DT_PSRAM_COMPAT := qc7xx-psram

config KERNEL_ENTRY
	default "__qc7xx_start"

config NUM_IRQS
	default 80

config SYS_CLOCK_HW_CYCLES_PER_SEC
	default $(dt_node_int_prop_int,/soc/timer@e000bff8,clock-frequency)

config SOC_ENABLE_XIP
	bool "Enable XIP for this SoC"
	default y
	select XIP
	help
	  Enable Execute In Place (XIP) for this SoC.

config RISCV_ALWAYS_SWITCH_THROUGH_ECALL
	default y if MULTITHREADING

config RISCV_MCAUSE_EXCEPTION_MASK
	default 0xFFF

config BOARD_FLASH_INIT_SKIP
	bool "Skip flash init for this SoC"
	default n
	help
	  Skip flash init for this SoC.

config BOARD_FLASH_LOW_SPEED
	bool "Enable Flash low speed for this SoC"
	default n
	help
	  Enable Flash low speed for this SoC.

config FLASH_XIP_LENGTH
	hex "Flash xip length"
	default 0x400000
	help
	  Length of the flash XIP region. Referenced by soc/qcom/qcc74x/common.ld
	  as the length of the rom memory region.

config PSRAM_LENGTH
	hex "PSRAM length"
	default 0
	help
	  Total PSRAM size in bytes (0 = disabled, 4 MB = 0x400000,
	  8 MB = 0x800000). Referenced by soc/qcom/qcc74x/common.ld as the
	  length of the ram_psram memory region when CONFIG_PSRAM is enabled.

config PSRAM_COPY_CODE
	bool "Enable psram copy code for this SoC"
	default n
	help
	  Enable the psram copy-code linker path in soc/qcom/qcc74x/common.ld,
	  which relocates selected code/data sections from flash to PSRAM at
	  boot for faster execution.

config PSRAM
	bool "Enable psram for this SoC"
	default y if $(dt_compat_enabled,$(DT_PSRAM_COMPAT))
	help
	  Enable application PSRAM support if a device-tree node with
	  compatible vendor,psram is present and enabled.

config COMMON_LIBC_MALLOC_ARENA_SIZE
        default 4096 if COMMON_LIBC_MALLOC

config PMP_SLOTS
	int "Number of PMP slots"
	default 16
	help
	  This is the number of PMP entries implemented by the hardware.
	  Typical values are 8 or 16.

config PMP_NO_NA4
	bool
	default y
	help
	  Set this if NA4 (Naturally Aligned 4-byte) mode is not supported.

config PMP_GRANULARITY
	default 128

config XTAL_POWER_TYPE_ACTIVE
	bool
	default n
	help
	  Get xtal power type

config MAIN_STACK_SIZE
	default 4096

config CACHE_MANAGEMENT
	default y

choice CACHE_TYPE
	default EXTERNAL_CACHE
endchoice

endif # SOC_SERIES_QCC74X
```
