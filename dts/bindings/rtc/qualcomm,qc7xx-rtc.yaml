## dts/bindings/rtc/qualcomm,qc7xx-rtc.yaml
```yaml
# SPDX-License-Identifier: Apache-2.0

description: Qualcomm's rtc

compatible: "qualcomm,qc7xx-rtc"

include: base.yaml

properties:
  reg:
    required: true

  clock-source:
    type: int
    default: 0
    description: Clock source of RTC.
```

## dts/bindings/sdhc/qcom,qcc74x-sdhc.yaml
```yaml
# Copyright (c) 2026 Qualcomm Technologies, Inc. and/or its subsidiaries
# SPDX-License-Identifier: BSD-3-Clause

description: Qualcomm Opal family SDHC controller

compatible: "qcom,qcc74x-sdhc"

include: [sdhc.yaml, pinctrl-device.yaml, reset-device.yaml]

properties:
  reg:
    required: true

  pinctrl-0:
    required: true

  pinctrl-names:
    required: true

  clocks:
    required: true

  interrupts:
    required: true

  bus-width:
    type: int
    default: 4
    description: |
      The bus width of the SDHC controller. The value should be 1 or 4.

  resets:
    required: true
```

## dts/bindings/sdhc/qualcomm,qc7xx-sdhc.yaml
```yaml
# Copyright (c) 2024 Espressif Systems (Shanghai) Co., Ltd.
# SPDX-License-Identifier: Apache-2.0

description: Qualcomm SDHC controller

compatible: "qualcomm,qc7xx-sdhc"

include: [sdhc.yaml, pinctrl-device.yaml]

properties:
  reg:
    required: true

  peripheral_name:
    type: string
    required: true

  pinctrl-0:
    required: true

  pinctrl-names:
    required: true

  clocks:
    required: true

  interrupts:
    required: true

  bus-width:
    type: int
    default: 4
    description: |
      The bus width of the SDHC controller. The value should be 1 or 4.
```

## dts/bindings/sdio/qcom,qcc74x-sdio.yaml
```yaml
# Copyright (c) 2026 Qualcomm Technologies, Inc. and/or its subsidiaries
# SPDX-License-Identifier: BSD-3-Clause

description: Qualcomm Opal family SDIO controller

compatible: "qcom,qcc74x-sdio"

bus: sdio

include: [pinctrl-device.yaml, base.yaml, reset-device.yaml]

properties:
  reg:
    required: true

  pinctrl-0:
    required: true

  pinctrl-names:
    required: true

  download-size-max:
    type: int
    default: 2048

  clocks:
    required: true

  resets:
    required: true

  "#address-cells":
    required: true
    const: 1

  "#size-cells":
    required: true
    const: 0
 
```

## dts/bindings/serial/qcom,qcc74x-uart.yaml
```yaml
# Copyright (c) 2026 Qualcomm Technologies, Inc. and/or its subsidiaries
# SPDX-License-Identifier: BSD-3-Clause

description: Qualcomm Opal family UART controller

compatible: "qcom,qcc74x-uart"

include: [uart-controller.yaml, uart-controller-pin-inversion.yaml, pinctrl-device.yaml, reset-device.yaml]

properties:
  reg:
    required: true

  pinctrl-0:
    required: true

  pinctrl-names:
    required: true

  resets:
    required: true

  clocks:
    required: true

  dmas:
    description: |
      DMA channels for TX and RX operations.
      First cell specifies the channel number,
      Second cell specifies the slot
      Third cell specifies the peripheral FIFO address.

  dma-names:
    description: |
      Should be "tx" and "rx" for transmit and receive DMA channels.
```

## dts/bindings/serial/qualcomm,qc7xx-uart.yaml
```yaml
# Copyright (c) 2026 Qualcomm Technologies, Inc. and/or its subsidiaries
# SPDX-License-Identifier: BSD-3-Clause

description: QUALCOMM UART

compatible: "qualcomm,qc7xx-uart"

include: [uart-controller.yaml, uart-controller-pin-inversion.yaml, pinctrl-device.yaml]

properties:
  reg:
    required: true

  index:
    type: int
    required: true

  pinctrl-0:
    required: true

  pinctrl-names:
    required: true

  clocks:
    required: true

  hw-rs485-hd-mode:
    type: boolean
    description: |
      Enable the hardware RS485 half duplex mode.
      Overrides hw-flow-control if both are set.
      Using this mode, the pin assigned to DTR
      is asserted during transmission.
```

## dts/bindings/spi/qcom,qcc74x-spi.yaml
```yaml
# Copyright (c) 2026 Qualcomm Technologies, Inc. and/or its subsidiaries
# SPDX-License-Identifier: BSD-3-Clause

description: Qualcomm Opal family SPI controller

compatible: "qcom,qcc74x-spi"

include: [spi-controller.yaml, pinctrl-device.yaml, reset-device.yaml]

properties:
  reg:
    required: true

  interrupts:
    required: true

  pinctrl-0:
    required: true

  pinctrl-names:
    required: true

  clocks:
    required: true

  resets:
    required: true

  dmas:
    description: |
      DMA channels for TX and RX operations.
      First cell specifies the channel number, 
      Second cell specifies the slot 
      Third cell specifies the peripheral FIFO address.

  dma-names:
    description: |
      Should be "tx" and "rx" for transmit and receive DMA channels.
```

## dts/bindings/spi/qualcomm,qc7xx-spi.yaml
```yaml
# Copyright (c) 2026 Qualcomm Technologies, Inc. and/or its subsidiaries
# SPDX-License-Identifier: Apache-2.0

description: QUALCOMM SPI

compatible: "qualcomm,qc7xx-spi"

include: [spi-controller.yaml, reset-device.yaml, pinctrl-device.yaml]

properties:
  reg:
    required: true

  peripheral_name:
    type: string
    required: true

  interrupts:
    required: true

  clocks:
    required: true

  pinctrl-0:
    required: true

  pinctrl-names:
    required: true

  dmas:
    description: |
      TX & RX dma specifiers.  Each specifier will have a phandle
      reference to the dma controller, the channel number, peripheral
      trigger source, and peripheral fifo address. The channel number
      is arbitrary but must not be reused. The number of channels
      available is device dependent.

      For example dmas for TX and RX may look like
        dmas = <&dma 2  DMA_REQUEST_SPI0_TX  DMA_ADDR_SPI0_TDR>,
               <&dma 3  DMA_REQUEST_SPI0_RX  DMA_ADDR_SPI0_RDR>;

  dma-names:
    description: |
      This should be "tx" and "rx" and should match the order given for
      dmas.

      For example using the example dmas, an example dma-names would be
         dma-names = "tx", "rx";
```

## dts/bindings/syscon/qcom,qcc74x-efuse.yaml
```yaml
# Copyright (c) 2026 Qualcomm Technologies, Inc. and/or its subsidiaries
# SPDX-License-Identifier: Apache-2.0

description: Qualcomm's Opal family efuse storage

compatible: "qcom,qcc74x-efuse"

include: base.yaml

properties:
  reg:
    required: true

  size:
    required: true
    type: int
    description: Size of efuse storage (bytes)
```

## dts/bindings/timer/qcom,qcc74x-mtimer.yaml
```yaml
# Copyright (c) 2026 Qualcomm Technologies, Inc. and/or its subsidiaries
# SPDX-License-Identifier: BSD-3-Clause

description: Qualcomm Opal RISC-V machine timer

compatible: "qcom,qcc74x-mtimer"

include: riscv,machine-timer.yaml

properties:
  clocks:
    required: true

  clock-frequency:
    type: int
    required: true
    description: Effective machine timer frequency in Hz.
```

## dts/bindings/usb/qcom,qcc74x-udc.yaml
```yaml
# Copyright (c) 2026 Qualcomm Technologies, Inc. and/or its subsidiaries
# SPDX-License-Identifier: BSD-3-Clause

description: Qualcomm's Opal family USB device controller

compatible: "qcom,qcc74x-udc"

include: [usb-ep.yaml, reset-device.yaml]

properties:
  reg:
    required: true

  interrupts:
    required: true

  resets:
    required: true
```

## dts/bindings/video/qcom,qcc74x-cam.yaml
```yaml
# Copyright (c) 2026 Qualcomm Technologies, Inc. and/or its subsidiaries
# SPDX-License-Identifier: BSD-3-Clause

description: Qualcomm's Opal family CAM Peripheral interface

compatible: "qcom,qcc74x-cam"

include: [base.yaml, pinctrl-device.yaml]

properties:
  pinctrl-0:
    required: true

  pinctrl-names:
    required: true

  reg:
    required: true    

  source:
    required: true
    type: phandle
    description: Connected source device, like image sensor.

  div:
    type: int
    default: 3
    description: |
      Value of the clock divider. Should be less or equal to 0x3.
```

## dts/bindings/video/qcom,qcc74x-jpeg.yaml
```yaml
# Copyright (c) 2026 Qualcomm Technologies, Inc. and/or its subsidiaries
# SPDX-License-Identifier: BSD-3-Clause

description: Qualcomm's Opal family HW JPEG encoder peripheral interface

compatible: "qcom,qcc74x-jpeg"

include: [base.yaml, reset-device.yaml]

properties:
  reg:
    required: true

  clocks:
    required: true

  interrupts:
    required: true

  resets:
    required: true
```

## dts/bindings/video/qualcomm,qc7xx-cam.yaml
```yaml
# Copyright (c) 2026 Qualcomm Technologies, Inc. and/or its subsidiaries
# SPDX-License-Identifier: Apache-2.0

description: QC7xx CAM DVP Peripheral interface

compatible: "qualcomm,qc7xx-cam-dvp"

include: [base.yaml, pinctrl-device.yaml]

properties:
  reg:
    required: true

  peripheral_name:
    type: string
    required: true

  interrupts:
    required: true

  clocks:
    required: true

  pinctrl-0:
    required: true

  pinctrl-names:
    required: true

  source:
    required: true
    type: phandle
    description: Connected source device, i.e. camera sensor

  pixel-clk:
    type: int
    description: camera clock frequency

  vsync-invert:
    type: boolean
    description: invert vsync signal

  hsync-invert:
    type: boolean
    description: invert hsync signal

  data-order-swap:
    type: boolean
    description: Camera input data order, The first data is higher-byte
  
```

## dts/bindings/watchdog/qcom,qcc74x-watchdog.yaml
```yaml
# Copyright (c) 2026 Qualcomm Technologies, Inc. and/or its subsidiaries
# SPDX-License-Identifier: BSD-3-Clause

description: Qualcomm Opal family watchdog controller

compatible: "qcom,qcc74x-watchdog"

include: [reset-device.yaml, base.yaml]

properties:
  reg:
    required: true

  clocks:
    required: true

  clock-div:
    type: int
    default: 19
    description: Watchdog prescaler.

  resets:
    required: true
```

## dts/bindings/watchdog/qualcomm,qc7xx-watchdog.yaml
```yaml
# SPDX-License-Identifier: Apache-2.0

description: Qualcomm's watchdog

compatible: "qualcomm,qc7xx-watchdog"

include: base.yaml

properties:
  reg:
    required: true

  clock-source:
    type: int
    default: 0
    description: Clock source of Watchdog.

  clock-div:
    type: int
    default: 0
    description: Watchdog prescaler.
```

## dts/bindings/wifi/qcom,qcc74x-wifi.yaml
```yaml
# Copyright (c) 2026 Qualcomm Technologies, Inc. and/or its subsidiaries
# SPDX-License-Identifier: BSD-3-Clause

description: Qualcomm Opal family Wi-Fi controller

compatible: "qcom,qcc74x-wifi"

include: reset-device.yaml
```

## dts/bindings/wifi/qualcomm,qcc74x-antenna-diversity.yaml
```yaml
# Copyright (c) 2026 Qualcomm Technologies, Inc. and/or its subsidiaries
# SPDX-License-Identifier: BSD-3-Clause

description: QCC74x Wi-Fi RF switch for two-antenna diversity

compatible: "qualcomm,qcc74x-antenna-diversity"

include: base.yaml

properties:
  select-gpios:
    type: phandle-array
    required: true
    description: |
      RF-switch selection GPIO. Logical active selects antenna 0 and logical
      inactive selects antenna 1. Use GPIO_ACTIVE_LOW when the board uses the
      opposite electrical polarity.
```

## lib/Kconfig
```kconfig
# Copyright (c) 2026 Qualcomm Technologies, Inc. and/or its subsidiaries
# SPDX-License-Identifier: BSD-3-Clause

config QCC74X_VIK_MEMCPY
	bool "Use the bounded Vik memcpy implementation"
	depends on RISCV_ISA_RV32I && LITTLE_ENDIAN && !MINIMAL_LIBC
	default y
	help
	  Replace the size-optimized libc memcpy with a RV32 variant of Daniel
	  Vik's word-copy implementation. Misaligned sources use aligned loads
	  plus shifts without reading outside the requested source range.
	  See lib/lib_vikmemcpy.c.
```

## soc/qcom/Kconfig
```kconfig
# Copyright (c) 2026 Qualcomm Technologies, Inc. and/or its subsidiaries
# SPDX-License-Identifier: BSD-3-Clause

if SOC_FAMILY_QCOM_QCC7XX

rsource "*/Kconfig"

endif # SOC_FAMILY_QCOM_QCC7XX
```

## soc/qcom/Kconfig.soc
```kconfig
# Copyright (c) 2026 Qualcomm Technologies, Inc. and/or its subsidiaries
# SPDX-License-Identifier: BSD-3-Clause

config SOC_FAMILY_QCOM_QCC7XX
	bool

config SOC_SERIES_QCC74X
	bool
	select SOC_FAMILY_QCOM_QCC7XX

config SOC_SERIES_QCC75X
	bool
	select SOC_FAMILY_QCOM_QCC7XX

config SOC_FAMILY
	default "qcom_qcc7xx" if SOC_FAMILY_QCOM_QCC7XX

rsource "*/Kconfig.soc"
```

## soc/qcom/Kconfig.sysbuild
```kconfig
# Copyright (c) 2026 Qualcomm Technologies, Inc. and/or its subsidiaries
# SPDX-License-Identifier: BSD-3-Clause

choice MCUBOOT_MODE
	default MCUBOOT_MODE_OVERWRITE_ONLY if SOC_FAMILY_QCOM_QCC7XX
endchoice
```

## soc/qcom/common/Kconfig.defconfig
```kconfig
# Copyright (c) 2026 Qualcomm Technologies, Inc. and/or its subsidiaries
# SPDX-License-Identifier: BSD-3-Clause

if SOC_FAMILY_QCOM_QCC7XX

config GEN_ISR_TABLES
	default y

config GEN_SW_ISR_TABLE
	default y

config GEN_IRQ_VECTOR_TABLE
	default n

config DYNAMIC_INTERRUPTS
	default y

config ISR_STACK_SIZE
	default 2048

config ATOMIC_OPERATIONS_C
	default y

config SYS_CLOCK_TICKS_PER_SEC
	default 1000

config MINIMAL_LIBC_OPTIMIZE_STRING_FOR_SIZE
	default n

config DCACHE_LINE_SIZE
	int
	default $(dt_node_int_prop_int,/cpus/cpu@0,d-cache-line-size)

config ICACHE_LINE_SIZE
	int
	default $(dt_node_int_prop_int,/cpus/cpu@0,i-cache-line-size)

if BOOTLOADER_MCUBOOT

config HAS_FLASH_LOAD_OFFSET
	default y

config MCUBOOT_GENERATE_UNSIGNED_IMAGE
	default y

config MCUBOOT_GENERATE_CONFIRMED_IMAGE
	default y

config ROM_START_OFFSET
	default 0x20

endif # BOOTLOADER_MCUBOOT

endif # SOC_FAMILY_QCOM_QCC7XX
```
