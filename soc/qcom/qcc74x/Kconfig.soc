## soc/qcom/qcc74x/Kconfig.soc
```kconfig
# Copyright (c) 2026 Qualcomm Technologies, Inc. and/or its subsidiaries
# SPDX-License-Identifier: BSD-3-Clause

config SOC_SERIES_QCC74X
	bool
	select SOC_FAMILY_QCOM_QCC7XX

config SOC_QCC7431
	bool
	select SOC_SERIES_QCC74X

config SOC_QCC7442
	bool
	select SOC_SERIES_QCC74X

config SOC_QCC7482
	bool
	select SOC_SERIES_QCC74X

config SOC_QCC7483
	bool
	select SOC_SERIES_QCC74X

config GEN_SW_ISR_TABLE
	bool

config SOC
	default "qcc7431" if SOC_QCC7431
	default "qcc7442" if SOC_QCC7442
	default "qcc7482" if SOC_QCC7482
	default "qcc7483" if SOC_QCC7483

config SOC_SERIES
	default "qcc74x" if SOC_SERIES_QCC74X
```

## soc/qcom/qcc75x/Kconfig.defconfig
```kconfig
# Copyright (c) 2026 Qualcomm Technologies, Inc. and/or its subsidiaries
# SPDX-License-Identifier: Apache-2.0

# Contains code under the following license:
#
# Not a contribution.
#
# Copyright (c) Zephyr Project members and individual contributors.
# SPDX-License-Identifier: Apache-2.0

if SOC_SERIES_QCC75X

DT_PSRAM_COMPAT := qc7xx-psram

config KERNEL_ENTRY
	default "__qc7xx_start"

config NUM_IRQS
	default 116

config SYS_CLOCK_HW_CYCLES_PER_SEC
	default $(dt_node_int_prop_int,/soc/timer@e000bff8,clock-frequency)

config SOC_ENABLE_XIP
	bool "Enable XIP for this SoC"
	default y
	select XIP
	help
	  Enable Execute In Place (XIP) for this SoC.

config RISCV_ALWAYS_SWITCH_THROUGH_ECALL
	default y if MULTITHREADING

config RISCV_MCAUSE_EXCEPTION_MASK
	default 0xFFF

config BOARD_FLASH_INIT_SKIP
	bool "Skip flash init for this SoC"
	default n
	help
	  Skip flash init for this SoC.

config BOARD_FLASH_LOW_SPEED
	bool "Enable Flash low speed for this SoC"
	default n
	help
	  Enable Flash low speed for this SoC.

config PSRAM
	bool "Enable psram for this SoC"
	default y if $(dt_compat_enabled,$(DT_PSRAM_COMPAT))
	help
	  Enable application PSRAM support if a device-tree node with
	  compatible vendor,psram is present and enabled.

config PMP_SLOTS
	int "Number of PMP slots"
	default 16
	help
	  This is the number of PMP entries implemented by the hardware.
	  Typical values are 8 or 16.

config PMP_NO_NA4
	bool
	default y
	help
	  Set this if NA4 (Naturally Aligned 4-byte) mode is not supported.

config PMP_GRANULARITY
	default 128

config MAIN_STACK_SIZE
	default 4096

config CACHE_MANAGEMENT
	default y

choice CACHE_TYPE
	default EXTERNAL_CACHE
endchoice

endif # SOC_SERIES_QCC75X
```

## soc/qcom/qcc75x/Kconfig.soc
```kconfig
# Copyright (c) 2026 Qualcomm Technologies, Inc. and/or its subsidiaries
# SPDX-License-Identifier: BSD-3-Clause

config SOC_SERIES_QCC75X
	bool
	select SOC_FAMILY_QCOM_QCC7XX

config SOC_QCC7510
	bool
	select SOC_SERIES_QCC75X

config SOC_QCC7512
	bool
	select SOC_SERIES_QCC75X

config GEN_SW_ISR_TABLE
	bool

config SOC
	default "qcc7510" if SOC_QCC7510
	default "qcc7512" if SOC_QCC7512

config SOC_SERIES
	default "qcc75x" if SOC_SERIES_QCC75X
```

## soc/qcom/qcr373/Kconfig
```kconfig
# Copyright (c) Qualcomm Technologies, Inc. and/or its subsidiaries
# SPDX-License-Identifier: BSD-3-Clause

config SOC_SERIES_QCR373
	select RISCV
	select RISCV_PRIVILEGED
	select RISCV_HAS_CLIC
	select INCLUDE_RESET_VECTOR
	select RISCV_SOC_HAS_GP_RELATIVE_ADDRESSING
	select DYNAMIC_INTERRUPTS
	select SHARED_INTERRUPTS
	select SOC_LATE_INIT_HOOK
	select CLOCK_CONTROL
	select ARCH_HAS_NOCACHE_MEMORY_SUPPORT
	select NOCACHE_MEMORY

	select RISCV_ISA_RV32I
	select RISCV_ISA_EXT_A
	select RISCV_ISA_EXT_M
	select RISCV_ISA_EXT_F
	select RISCV_ISA_EXT_D
	select RISCV_ISA_EXT_C
	select RISCV_ISA_EXT_ZICSR
	select RISCV_ISA_EXT_ZIFENCEI
	select HAS_QCOM_QCR373_HAL
	select CPU_HAS_FPU
	select CPU_HAS_FPU_DOUBLE_PRECISION
	select CPU_HAS_DCACHE
	select CPU_HAS_ICACHE
	select RISCV_PMP
	select FPU
	select ARCH_HAS_TRUSTED_EXECUTION
```

## soc/qcom/qcr373/Kconfig.defconfig
```kconfig
# Copyright (c) Qualcomm Technologies, Inc. and/or its subsidiaries
# SPDX-License-Identifier: BSD-3-Clause

if SOC_SERIES_QCR373

DT_PSRAM_COMPAT := qc7xx-psram

config KERNEL_ENTRY
	default "__qcr373_start"

config NUM_IRQS
	default 117

config COUNTER_INIT_PRIORITY
	default 40 if COUNTER_QCR373_RTC

config SYS_CLOCK_HW_CYCLES_PER_SEC
	default $(dt_node_int_prop_int,/soc/timer@e000bff8,clock-frequency)

config SOC_ENABLE_XIP
	bool "Enable XIP for this SoC"
	default y
	select XIP
	help
	  Enable Execute In Place (XIP) for this SoC.

config RISCV_ALWAYS_SWITCH_THROUGH_ECALL
	default y if MULTITHREADING

config RISCV_MCAUSE_EXCEPTION_MASK
	default 0xFFF

config BOARD_FLASH_INIT_SKIP
	bool "Skip flash init for this SoC"
	default n
	help
	  Skip flash init for this SoC.

config BOARD_FLASH_LOW_SPEED
	bool "Enable Flash low speed for this SoC"
	default n
	help
	  Enable Flash low speed for this SoC.

config QCR373_BUILD_POST_PROCESS
	bool "Run QCR373 vendor image post-processing tools"
	default y
	help
	  Run the QCR373 secure-image and flash-image tools after linking.
	  The matching QCR373 tool bundle must be installed for this option.

config QCR373_MULTI_IMAGE
	bool "Build a combined AP and NP image"
	depends on SOC_QCR373_AP
	help
	  Add an NP child-image descriptor to the AP firmware and append the
	  independently processed NP image before processing AP. The resulting
	  AP image is the bootable combined firmware.

config QCR373_REMOTE_IMAGE
	string "Processed NP image path"
	depends on QCR373_MULTI_IMAGE
	help
	  Path to the processed NP binary supplied by sysbuild.

config PSRAM
	bool "Enable psram for this SoC"
	default y if $(dt_compat_enabled,$(DT_PSRAM_COMPAT))
	help
	  Enable application PSRAM support if a device-tree node with
	  compatible vendor,psram is present and enabled.

config EXECUTE_CODE_FROM_PSRAM
	bool "Execute application code from PSRAM"
	depends on PSRAM
	default n
	help
	  Relocate normal text and read-only data from flash to PSRAM during
	  early startup, then execute the application from PSRAM. Code needed
	  to perform the relocation remains in flash.

config COMMON_LIBC_MALLOC_ARENA_SIZE
        default 4096 if COMMON_LIBC_MALLOC

config PMP_SLOTS
	int "Number of PMP slots"
	default 16
	help
	  This is the number of PMP entries implemented by the hardware.
	  Typical values are 8 or 16.

config PMP_NO_NA4
	bool
	default y
	help
	  Set this if NA4 (Naturally Aligned 4-byte) mode is not supported.

config PMP_GRANULARITY
	default 128

config MAIN_STACK_SIZE
	default 4096

config CACHE_MANAGEMENT
	default y

choice CACHE_TYPE
	default EXTERNAL_CACHE
endchoice

endif # SOC_SERIES_QCR373
```

## soc/qcom/qcr373/Kconfig.soc
```kconfig
# Copyright (c) Qualcomm Technologies, Inc. and/or its subsidiaries
# SPDX-License-Identifier: BSD-3-Clause

config SOC_SERIES_QCR373
	bool
	select SOC_FAMILY_QCOM_QCC7XX

config SOC_QCR373
	bool
	select SOC_SERIES_QCR373

config SOC_QCR373_AP
	bool
	help
	  Build an image for the QCR373 application processor. In a multi-image
	  build, the AP image is responsible for loading and starting the NP image.

config SOC_QCR373_NP
	bool
	help
	  Build the QCR373 network processor child image. The NP image is not a
	  standalone boot image and must be loaded and started by the AP image.

config GEN_SW_ISR_TABLE
	bool

config SOC
	default "qcr373" if SOC_QCR373

config SOC_SERIES
	default "qcr373" if SOC_SERIES_QCR373
```

## soc/qcom/qcr3xx/Kconfig.soc
```kconfig
# Copyright (c) Qualcomm Technologies, Inc. and/or its subsidiaries
# SPDX-License-Identifier: BSD-3-Clause

config SOC_SERIES_QCR3XX
	bool
	select SOC_FAMILY_QCOM_QCC7XX

config SOC_QCR3034
	bool
	select SOC_SERIES_QCR3XX

config SOC_QCR3733
	bool
	select SOC_SERIES_QCR3XX

config SOC_QCR3734
	bool
	select SOC_SERIES_QCR3XX

config SOC_QCR3XX_AP
	bool
	help
	  Build an image for the QCR373 application processor. In a multi-image
	  build, the AP image is responsible for loading and starting the NP image.

config SOC_QCR3XX_NP
	bool
	help
	  Build the QCR373 network processor child image. The NP image is not a
	  standalone boot image and must be loaded and started by the AP image.

config GEN_SW_ISR_TABLE
	bool

config SOC
	default "qcr3034" if SOC_QCR3034
	default "qcr3733" if SOC_QCR3733
	default "qcr3734" if SOC_QCR3734

config SOC_SERIES
	default "qcr3xx" if SOC_SERIES_QCR3XX
```
